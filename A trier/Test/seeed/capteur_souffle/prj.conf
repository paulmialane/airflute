## prj.conf
```kconfig
CONFIG_GPIO=y
CONFIG_ADC=y
CONFIG_BOOT_DELAY=5000
```

## src/main.c
```c
#include <stdio.h>
#include <zephyr/kernel.h>
#include <zephyr/drivers/gpio.h>
#include <zephyr/drivers/adc.h>
#include <math.h>
#include "capteur_souffle.h"

int main(){
    int reference = init_capteur();
    
    int data_out=0;
    while(1){
        data_out = souffle_force(reference);

        printk("%i\n", data_out);

        k_msleep(50);
    }
}
```

## src/capteur_souffle.c
```c
#include <stdio.h>
#include <zephyr/kernel.h>
#include <zephyr/drivers/gpio.h>
#include <zephyr/drivers/adc.h>
#include <math.h>


static const struct adc_dt_spec adc_a0 =  ADC_DT_SPEC_GET_BY_IDX(DT_PATH(zephyr_user), 0);

int sensor_threshold = 10;

// une seule donnée de 16bits
int16_t buf = 33;
struct adc_sequence sequence = {
		.buffer = &buf,
		/* buffer size in bytes, not number of samples */
		.buffer_size = sizeof(buf),
		//Optional
		//.calibrate = true,
	};









const int init_capteur(){
   
   int err1;
  // Configure the button pin as input
   if(adc_is_ready_dt(&adc_a0))
   printf("ADC is ready\n");
   else
   printf("ADC NOT ready\n");

   err1 = adc_channel_setup_dt(&adc_a0);
   if (err1 < 0) {
      printk("Error in ADC setup (%d)\n", err1);
      return err1;
   }
   err1 = adc_sequence_init_dt(&adc_a0, &sequence);
   if (err1 < 0) {
      printk("Error in the ADC sequence initialization (%d)\n", err1);
      return err1;
   }

   
   int moyenne=0;
   int longueur = 100;
   for (int i =0; i<longueur-1; i++){
      err1 = adc_read(adc_a0.dev, &sequence);
      moyenne += buf; 
      k_msleep(10);
   }
   const int reference = (int) moyenne/longueur;
   printk("capteur initialisé à %i\n",reference);
   return reference;
}

int filtre(int data, int REFERENCE){//pas mal de travail ici
   if (data>REFERENCE-sensor_threshold){
      return 0;
   }
   else if (REFERENCE-data>127) {
      return 127;
   }
   
   return REFERENCE-data;
}







/// fonctions

int souffle_yes_no(int reference){
   int err;
   err = adc_read(adc_a0.dev, &sequence);
   int data = err;
   if (data>reference-sensor_threshold){
      return 0;
   }
   else{
      return 1;
   }
}


int souffle_force(int reference){
   int err;
   err = adc_read(adc_a0.dev, &sequence);
   int data_out = 0;
   if (err < 0) {
         printk("Error reading the ADC (#%d)", err);
   }
   else {
         data_out = filtre(buf, reference);
   }
   return data_out;
}
```

## src/main_old_working.c
```c
#include <stdio.h>
#include <zephyr/kernel.h>
#include <zephyr/drivers/gpio.h>
#include <zephyr/drivers/adc.h>
#include <math.h>




static const struct adc_dt_spec adc_a0 =  ADC_DT_SPEC_GET_BY_IDX(DT_PATH(zephyr_user), 0);

// une seule donnée de 16bits
int16_t buf = 33;
struct adc_sequence sequence = {
		.buffer = &buf,
		/* buffer size in bytes, not number of samples */
		.buffer_size = sizeof(buf),
		//Optional
		//.calibrate = true,
	};


int init_capteur(int err){
   int moyenne=0;
   int longueur = 100;
   for (int i =0; i<longueur-1; i++){
      err = adc_read(adc_a0.dev, &sequence);
      moyenne += buf; 
      k_msleep(10);
   }
   return (int) moyenne/longueur;
}

int filtre(int data, int reference){//pas mal de travail ici
   if (data>reference-100){
      return 0;
   }
   else if (reference-data>256) {
      return pow(256,2);
   }
   
   printk("données référence : %i   données capteur :%i \n",reference, data);
   return (int) pow(reference-data,2);
}







int main(void)
{
   int err;


  // Configure the button pin as input
  if(adc_is_ready_dt(&adc_a0))
    printf("ADC is ready\n");
  else
    printf("ADC NOT ready\n");

   err = adc_channel_setup_dt(&adc_a0);
   if (err < 0) {
      printk("Error in ADC setup (%d)\n", err);
      return err;
   }
   err = adc_sequence_init_dt(&adc_a0, &sequence);
   if (err < 0) {
      printk("Error in the ADC sequence initialization (%d)\n", err);
      return err;
   }


   int reference = init_capteur(err);
   printf("capteur initialisé à %i\n",reference);
   int data_out;

   while (1){
      err = adc_read(adc_a0.dev, &sequence);
      if (err < 0) {
         printk("Error reading the ADC (#%d)", err);
         continue;
      } else {
         data_out = filtre(buf, reference);
         printk("%i\n", data_out);
      }
      k_msleep(500);
   }

}
```
