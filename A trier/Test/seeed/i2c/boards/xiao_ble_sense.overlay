&i2c1 {
    pcf8574_1: pcf8574@20 {
        compatible = "nxp,pcf857x";
        status = "okay";
        reg = <0x20>;
        gpio-controller;
        #gpio-cells = <2>;
        ngpios = <8>;
    };
};
