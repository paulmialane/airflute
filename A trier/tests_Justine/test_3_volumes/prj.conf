## prj.conf
```kconfig
CONFIG_PRINTK=y
CONFIG_HEAP_MEM_POOL_SIZE=256
CONFIG_ASSERT=y
CONFIG_GPIO=y
CONFIG_ADC=y
CONFIG_I2C=y

CONFIG_BOOT_DELAY=5000
CONFIG_BT=y
CONFIG_BT_PERIPHERAL=y
CONFIG_BT_DEVICE_NAME="zephyr-ble-midi-Juju"
# CONFIG_BT_DEBUG_LOG=y

CONFIG_BLE_MIDI=y

CONFIG_LOG=y
CONFIG_BLE_MIDI_LOG_LEVEL_INF=y

# Request a large MTU to reduce the risk of
# dropped data when sending lots of MIDI messages at once.
# Also increases streaming sysex throughput.
# https://docs.zephyrproject.org/latest/samples/bluetooth/mtu_update/README.html
CONFIG_BT_L2CAP_TX_MTU=247
CONFIG_BT_BUF_ACL_TX_SIZE=251
CONFIG_BT_BUF_ACL_RX_SIZE=251
CONFIG_BLE_MIDI_TX_PACKET_MAX_SIZE=244

CONFIG_RING_BUFFER=y

# CONFIG_BLE_MIDI_TX_MODE_SINGLE_MSG=y
# CONFIG_BLE_MIDI_TX_MODE_MANUAL=y
# CONFIG_BLE_MIDI_TX_MODE_NRF_RADIO_NOTIF=y

# CONFIG_ASSERT=y
# CONFIG_DEBUG_OPTIMIZATIONS=y
# CONFIG_DEBUG_THREAD_INFO=y
CONFIG_BT_SMP=y
CONFIG_BT_SMP_ALLOW_UNAUTH_OVERWRITE=y
```

## src/combinationToMidi.c
```c
#include "combinationToMidi.h"
#include <stdio.h>
#include <stdint.h>
#include <stdbool.h>



#define NB_BUTTONS 8
#define NB_NOTES 27
// Whether we want to add or subtract an octave to the note (1/0/-1)
#define OCTAVE 0

/* Key combination definition.

 In case we want to change the bindings, all we have to do is change the following constants.

 Example:
    If we want to change the binding of the C key to the first 4 buttons, we would change the C constant to:
    const uint8_t C = (1<<0) | (1<<1) | (1<<2) | (1<<3);

*/
const uint8_t CSharp = 0;
const uint8_t C = (1<<1);
const uint8_t B = 1;
const uint8_t Bb = 1 | (1<<3);
const uint8_t ASharp = 1 | (1<<1) | (1<<3);
const uint8_t A = 1 | (1<<1);
const uint8_t GSharp = 1 | (1<<1) | (1<<2) | (1<<3);
const uint8_t G = 1 | (1<<1) | (1<<2);
const uint8_t FSharp = 1 | (1<<1) | (1<<2) | (1<<5);
const uint8_t F = 1 | (1<<1) | (1<<2) | (1<<4);
const uint8_t E = 1 | (1<<1) | (1<<2) | (1<<4) | (1<<5);
const uint8_t DSharp = 1 | (1<<1) | (1<<2) | (1<<3) | (1<<4) | (1<<5) | (1<<6);
const uint8_t D = 1 | (1<<1) | (1<<2) | (1<<4) | (1<<5) | (1<<6);
const uint8_t CSharpPlus = CSharp | (1<<7);
const uint8_t CPlus = C | (1<<7);
const uint8_t BPlus = B | (1<<7);
const uint8_t BbPlus = Bb | (1<<7);
const uint8_t ASharpPlus = ASharp | (1<<7);
const uint8_t APlus = A | (1<<7);
const uint8_t GSharpPlus = GSharp | (1<<7);
const uint8_t GPlus = G | (1<<7);
const uint8_t FSharpPlus = FSharp | (1<<7);
const uint8_t FPlus = F | (1<<7);
const uint8_t EPlus = E | (1<<7);
const uint8_t DSharpPlus = DSharp | (1<<7);
const uint8_t DPlus = D | (1<<7);
const uint8_t DPlusPlus = (1<<1) | (1<<2) | (1<<7);

/* A structure to hold the note information

  A note is defined by a key mask, a MIDI pitch and a name.
  The key mask is a bit mask that represents the keys that are pressed.
  The MIDI pitch is the MIDI pitch of the note according to the MIDI standard.
  The name is the name of the note.

  Example:
    The C note is defined by the following:
        keyMask = 0b00000010
        midiPitch = 72
        name = "C"
 */

typedef struct {
    uint8_t keyMask;
    uint8_t midiPitch;
    char *name;
} note_t;


/* Macro to initialize a note

  This macro is used to initialize a note structure.
  It takes 3 arguments:
      - k: the key mask
      - m: the MIDI pitch
      - n: the name of the note

  In case the midiPitch is greater than 127, it will be truncated to 127.

  Example:
      To initialize the C note, we would use the following: NOTE_INIT(C, 72, "C")

 */
#define NOTE_INIT(k, m, n) {.keyMask=k, .midiPitch=(m&0xff), .name=n}

const note_t noteArray[NB_NOTES] = {
    NOTE_INIT(CSharp, 73+OCTAVE*12, "C#"),
    NOTE_INIT(C, 72+OCTAVE*12, "C"),
    NOTE_INIT(B, 71+OCTAVE*12, "B"),
    NOTE_INIT(Bb, 70+OCTAVE*12, "Bb"),
    NOTE_INIT(ASharp, 70+OCTAVE*12, "A#"),
    NOTE_INIT(A, 69+OCTAVE*12, "A"),
    NOTE_INIT(GSharp, 68+OCTAVE*12, "G#"),
    NOTE_INIT(G, 67+OCTAVE*12, "G"),
    NOTE_INIT(FSharp, 66+OCTAVE*12, "F#"),
    NOTE_INIT(F, 65+OCTAVE*12, "F"),
    NOTE_INIT(E, 64+OCTAVE*12, "E"),
    NOTE_INIT(DSharp, 63+OCTAVE*12, "D#"),
    NOTE_INIT(D, 62+OCTAVE*12, "D"),
    NOTE_INIT(CSharpPlus, 85+OCTAVE*12, "+C#"),
    NOTE_INIT(CPlus, 84+OCTAVE*12, "+C"),
    NOTE_INIT(BPlus, 83+OCTAVE*12, "+B"),
    NOTE_INIT(BbPlus, 82+OCTAVE*12, "+Bb"),
    NOTE_INIT(ASharpPlus, 82+OCTAVE*12, "+A#"),
    NOTE_INIT(APlus, 81+OCTAVE*12, "+A"),
    NOTE_INIT(GSharpPlus, 80+OCTAVE*12, "+G#"),
    NOTE_INIT(GPlus, 79+OCTAVE*12, "+G"),
    NOTE_INIT(FSharpPlus, 78+OCTAVE*12, "+F#"),
    NOTE_INIT(FPlus, 77+OCTAVE*12, "+F"),
    NOTE_INIT(EPlus, 76+OCTAVE*12, "+E"),
    NOTE_INIT(DSharpPlus, 75+OCTAVE*12, "+D#"),
    NOTE_INIT(DPlus, 74+OCTAVE*12, "+D"),
    NOTE_INIT(DPlusPlus, 86+OCTAVE*12, "++D")
};


uint8_t combinationToMidi(uint8_t sensorValues) {
    /*
        This function takes the sensor values and returns the MIDI pitch of the note that corresponds to the sensor values.

        If the sensor values do not correspond to any note, the function looks for a close key combination. If none is found, it returns 127.
     */
    for (int i = 0; i < NB_NOTES; i++) {
        if (noteArray[i].keyMask == sensorValues) {
            return noteArray[i].midiPitch;
        }
    }
    /*for (int i = 0; i < NB_NOTES; i++) {
        if (hammingDistance(sensorValues, noteArray[i].keyMask) == 1) {
            return noteArray[i].midiPitch;
        }
    }
    for (int i = 0; i < NB_NOTES; i++) {
        if (hammingDistance(sensorValues, noteArray[i].keyMask) == 2) {
            return noteArray[i].midiPitch;
        }
    }*/
    return 127;
}

const char * fromSensorToPitchName(uint8_t sensorValues) {
    /*
        This function takes the sensor values and returns the MIDI pitch of the note that corresponds to the sensor values.

        If the sensor values do not correspond to any note, the function looks for a close key combination. If none is found, it returns 127.
     */
    for (int i = 0; i < NB_NOTES; i++) {
        if (noteArray[i].keyMask == sensorValues) {
            return noteArray[i].name;
        }
    }
    /*for (int i = 0; i < NB_NOTES; i++) {
        if (hammingDistance(sensorValues, noteArray[i].keyMask) == 1) {
            return noteArray[i].midiPitch;
        }
    }
    for (int i = 0; i < NB_NOTES; i++) {
        if (hammingDistance(sensorValues, noteArray[i].keyMask) == 2) {
            return noteArray[i].midiPitch;
        }
    }*/
    return "not a note";
}


int hammingDistance(uint8_t a, uint8_t b) {
    /*
        This function calculates the Hamming distance between two numbers.

        The Hamming distance is the number of positions at which the corresponding bits are different.

        Example:
            The Hamming distance between 0b1010 and 0b1001 is 2.
     */
    int distance = 0;
    uint8_t c = a ^ b;
    while (c) {
        distance++;
        c &= c - 1;
    }
    return distance;
}
```

## src/dataType.h
```c
#include <stdbool.h>

struct note_data {
	void *fifo_reserved; /* 1st word reserved for use by fifo */
	int buttons;
	int strength;
	int note;
	bool on;
};
```

## src/playSingleNote.c
```c
#include "playSingleNote.h"

#include <zephyr/kernel.h>
#include <zephyr/drivers/gpio.h>
#include <zephyr/bluetooth/uuid.h>
#include <zephyr/bluetooth/gatt.h>
#include <zephyr/bluetooth/bluetooth.h>
#include <zephyr/sys/ring_buffer.h>
#include "include/ble_midi/ble_midi.h"
#include <stdio.h>
#include "dataType.h"

/************************ App state ************************/
K_MSGQ_DEFINE(button_event_q, sizeof(uint8_t), 128, 4);

#define SYSEX_TX_MESSAGE_SIZE 2000
#define SYSEX_TX_MAX_CHUNK_SIZE 240

struct sample_app_state_t
{
        int ble_midi_is_available;
        int sysex_rx_data_byte_count;
        int sysex_tx_data_byte_count;
        int sysex_tx_in_progress;
        int button_states[4];
};

struct sample_app_state_t sample_app_state = {.ble_midi_is_available = 0,
                                                     .sysex_tx_data_byte_count = 0,
                                                     .sysex_tx_in_progress = 0,
                                                     .sysex_rx_data_byte_count = 0,
                                                     .button_states = {0, 0, 0, 0}};

/* Ringbuf/work queue */
RING_BUF_DECLARE(midi_msg_ringbuf, 128);
static void midi_msg_work_cb(struct k_work *w)
{
        uint8_t data[4] = {0, 0, 0, 0};
        while (ring_buf_get(&midi_msg_ringbuf, &data, 4) == 4)
        {
                uint8_t msg_byte_count = data[0];
                uint8_t *msg_bytes = &data[1];
                for (int i = 0; i < msg_byte_count; i++)
                {
                        printk("%02x ", msg_bytes[i]);
                }
                printk("\n");
        };
}
static K_WORK_DEFINE(midi_msg_work, midi_msg_work_cb);

/****************** BLE MIDI callbacks ******************/
static void ble_midi_available_cb(int is_available)
{
        printk("ble_midi_is_available : %d", is_available);
        sample_app_state.ble_midi_is_available = is_available;
}

static void tx_done_cb()
{
        if (sample_app_state.sysex_tx_in_progress)
        {
                if (sample_app_state.sysex_tx_data_byte_count == SYSEX_TX_MESSAGE_SIZE)
                {
                        ble_midi_tx_sysex_end();
                        sample_app_state.sysex_tx_in_progress = 0;
                }
                else
                {
                        uint8_t chunk[SYSEX_TX_MAX_CHUNK_SIZE];
                        for (int i = 0; i < SYSEX_TX_MAX_CHUNK_SIZE; i++)
                        {
                                chunk[i] = (sample_app_state.sysex_tx_data_byte_count + i) % 128;
                        }
                        int num_bytes_left =
                            SYSEX_TX_MESSAGE_SIZE - sample_app_state.sysex_tx_data_byte_count;
                        int num_bytes_to_send = num_bytes_left < SYSEX_TX_MAX_CHUNK_SIZE
                                                    ? num_bytes_left
                                                    : SYSEX_TX_MAX_CHUNK_SIZE;
                        int num_bytes_sent = ble_midi_tx_sysex_data(chunk, num_bytes_to_send);
                        sample_app_state.sysex_tx_data_byte_count += num_bytes_sent;
                }
        }
}

/** Called when a non-sysex message has been parsed */
static void ble_midi_message_cb(uint8_t *bytes, uint8_t num_bytes, uint16_t timestamp)
{
        uint8_t data[4] = {num_bytes, 0, 0, 0};
        for (int i = 0; i < num_bytes; i++)
        {
                data[i + 1] = bytes[i];
        }
        uint32_t num_bytes_written = ring_buf_put(&midi_msg_ringbuf, &data, 4);
        __ASSERT(num_bytes_written == 4, "Failed to write to MIDI msg ringbuf");
        int submit_rc = k_work_submit(&midi_msg_work);
}

/** Called when a sysex message starts */
static void ble_midi_sysex_start_cb(uint16_t timestamp)
{
        printk("rx sysex start, t %d\n", timestamp);
}
/** Called when a sysex data byte has been received */
static void ble_midi_sysex_data_cb(uint8_t data_byte)
{
        printk("rx sysex byte %02x\n", data_byte);
}
/** Called when a sysex message ends */
static void ble_midi_sysex_end_cb(uint16_t timestamp)
{
        printk("rx sysex end, t %d\n", timestamp);
}

#define DEVICE_NAME CONFIG_BT_DEVICE_NAME
#define DEVICE_NAME_LEN (sizeof(DEVICE_NAME) - 1)

static const struct bt_data ad[] = {
    BT_DATA_BYTES(BT_DATA_FLAGS, (BT_LE_AD_GENERAL | BT_LE_AD_NO_BREDR)),
    BT_DATA(BT_DATA_NAME_COMPLETE, DEVICE_NAME, DEVICE_NAME_LEN)};

static const struct bt_data sd[] = {
    BT_DATA_BYTES(BT_DATA_UUID128_ALL, BLE_MIDI_SERVICE_UUID),
};


int isConnectedOverBLE(void){
        return sample_app_state.ble_midi_is_available;
}


void midiInitialize(void){

    uint32_t err = bt_enable(NULL);
    __ASSERT(err == 0, "bt_enable failed");

    /* Must be called after bt_enable */
        
    struct ble_midi_callbacks midi_callbacks = {.available_cb = ble_midi_available_cb,
                                                    .tx_done_cb = tx_done_cb,
                                                    .midi_message_cb = ble_midi_message_cb,
                                                    .sysex_start_cb = ble_midi_sysex_start_cb,
                                                    .sysex_data_cb = ble_midi_sysex_data_cb,
                                                    .sysex_end_cb = ble_midi_sysex_end_cb};
    ble_midi_init(&midi_callbacks);

    int ad_err = bt_le_adv_start(BT_LE_ADV_CONN, ad, ARRAY_SIZE(ad), sd, ARRAY_SIZE(sd));
    printk("bt_le_adv_start %d\n", ad_err);
}


void sendNote(bool on_off, int note, int force){
    if (!sample_app_state.sysex_tx_in_progress)
    {
        uint8_t toPlay[3] = {on_off ? 0x90 : 0x80, note, force};
        // printk("going to play note number %d with on = %d\n", note, on_off);
        ble_midi_tx_msg(toPlay);
    }
}
```
