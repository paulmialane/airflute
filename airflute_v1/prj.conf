## CMakeLists.txt
```
# SPDX-License-Identifier: Apache-2.0

list(APPEND ZEPHYR_EXTRA_MODULES
  ${CMAKE_CURRENT_SOURCE_DIR}
  )

cmake_minimum_required(VERSION 3.20.0)
find_package(Zephyr REQUIRED HINTS $ENV{ZEPHYR_BASE})
project(airflute_v1)


target_sources(app PRIVATE src/main.c)
target_sources(app PRIVATE src/blinkLed.c)
target_sources(app PRIVATE src/blowSensor.c)
target_sources(app PRIVATE src/buttonStatus.c)
target_sources(app PRIVATE src/combinationToMidi.c)
target_sources(app PRIVATE src/bluetoothThread.c)
target_sources(app PRIVATE src/playSingleNote.c)
target_sources(app PRIVATE src/mainCycle.c)
```

## prj.conf
```kconfig
CONFIG_PRINTK=y
CONFIG_HEAP_MEM_POOL_SIZE=512
CONFIG_ASSERT=y
CONFIG_GPIO=y
CONFIG_ADC=y
CONFIG_I2C=y

CONFIG_BOOT_DELAY=5000
CONFIG_BT=y
CONFIG_BT_PERIPHERAL=y
CONFIG_BT_DEVICE_NAME="Airflute"
# CONFIG_BT_DEBUG_LOG=y

CONFIG_BLE_MIDI=y

CONFIG_LOG=y
CONFIG_BLE_MIDI_LOG_LEVEL_INF=y

# Request a large MTU to reduce the risk of
# dropped data when sending lots of MIDI messages at once.
# Also increases streaming sysex throughput.
# https://docs.zephyrproject.org/latest/samples/bluetooth/mtu_update/README.html
CONFIG_BT_L2CAP_TX_MTU=247
CONFIG_BT_BUF_ACL_TX_SIZE=251
CONFIG_BT_BUF_ACL_RX_SIZE=251
CONFIG_BLE_MIDI_TX_PACKET_MAX_SIZE=244

CONFIG_RING_BUFFER=y

# CONFIG_BLE_MIDI_TX_MODE_SINGLE_MSG=y
# CONFIG_BLE_MIDI_TX_MODE_MANUAL=y
# CONFIG_BLE_MIDI_TX_MODE_NRF_RADIO_NOTIF=y

# CONFIG_ASSERT=y
# CONFIG_DEBUG_OPTIMIZATIONS=y
# CONFIG_DEBUG_THREAD_INFO=y
CONFIG_BT_SMP=y
CONFIG_BT_SMP_ALLOW_UNAUTH_OVERWRITE=y
```

## src/main.c
```c
#include <zephyr/kernel.h>
#include <zephyr/device.h>
#include <zephyr/drivers/gpio.h>
#include <zephyr/sys/printk.h>
#include <zephyr/sys/__assert.h>


#include "blinkLed.h"
#include "mainCycle.h"

#define STACKSIZE 1024
#define PRIORITY 4

void mainCycleInit(){
    // Here we initialize the main thread

    mainCycleThread();
}
 


// A thread to blink the led as it is usefull to know if the board is still alive
K_THREAD_DEFINE(blinkId, STACKSIZE, blink, NULL, NULL, NULL, PRIORITY, 0, 0);

K_THREAD_DEFINE(mainId, STACKSIZE, mainCycleInit, NULL, NULL, NULL, PRIORITY, 0, 0);
```

## src/blowSensor.c
```c
#include "blowSensor.h"

#include <stdio.h>
#include <zephyr/kernel.h>
#include <zephyr/drivers/gpio.h>
#include <zephyr/drivers/adc.h>
#include <math.h>


static const struct adc_dt_spec adc_a0 =  ADC_DT_SPEC_GET_BY_IDX(DT_PATH(zephyr_user), 0);

int sensor_threshold = 25;

// une seule donnée de 16bits
int16_t buf = 33;
struct adc_sequence sequence = {
		.buffer = &buf,
		/* buffer size in bytes, not number of samples */
		.buffer_size = sizeof(buf),
		//Optional
		//.calibrate = true,
	};


int sensorInit(void){
   
   int err1;
  // Configure the button pin as input
   if(adc_is_ready_dt(&adc_a0))
   printf("ADC is ready\n");
   else
   printf("ADC NOT ready\n");

   err1 = adc_channel_setup_dt(&adc_a0);
   if (err1 < 0) {
      printk("Error in ADC setup (%d)\n", err1);
      return err1;
   }
   err1 = adc_sequence_init_dt(&adc_a0, &sequence);
   if (err1 < 0) {
      printk("Error in the ADC sequence initialization (%d)\n", err1);
      return err1;
   }

   
   int moyenne=0;
   int longueur = 100;
   for (int i =0; i<longueur-1; i++){
      err1 = adc_read(adc_a0.dev, &sequence);
      moyenne += buf; 
      k_msleep(10);
   }
   const int reference = (int) moyenne/longueur;
   printk("capteur initialisé à %i\n",reference);
   return reference;
}

int filtre(int data, int REFERENCE){//pas mal de travail ici
   if (data>REFERENCE-sensor_threshold){
      return 0;
   }
   else if (REFERENCE-data-sensor_threshold>127) {
      return 127;
   }
   
   return REFERENCE-data-sensor_threshold;
}







/// fonctions

int blowingOnOff(int reference){
   int err;
   err = adc_read(adc_a0.dev, &sequence);
   int data_out = 0;
   if (err < 0) {
         printk("Error reading the ADC (#%d)", err);
   }
   else {
      data_out = filtre(buf, reference);
      if (data_out){
         return 1;
      }
      else{
         return 0;
      }
   }
}


int blowingStrength(int reference){
   int err;
   err = adc_read(adc_a0.dev, &sequence);
   int data_out = 0;
   if (err < 0) {
         printk("Error reading the ADC (#%d)", err);
   }
   else {
         data_out = filtre(buf, reference);
   }
   return data_out;
}
```

## src/blowSensor.h
```c
int sensorInit(void);
int blowingOnOff(int);
int blowingStrength(int);
```

## src/mainCycle.c
```c
#include <zephyr/kernel.h>
#include <zephyr/device.h>
#include <zephyr/drivers/gpio.h>
#include <zephyr/sys/printk.h>
#include <zephyr/sys/__assert.h>

#include "dataType.h"
#include "mainCycle.h"
#include "blowSensor.h"
#include "buttonStatus.h"
#include "combinationToMidi.h"
#include "playSingleNote.h"


void mainCycleThread(){

	int reference;
	reference = sensorInit();

	midiInitialize();
	printk("------------------\nMidi initialisé\n------------------\n\n");

	struct note_data currentlyPlaying = {.buttons = -1, .note = -1, .on = 0, .strength = 0};
	/*
	Initialization of the "note we are currently playing" 
	(except we are not playing anything at the beginning, so we use impossible values)
	*/

	while(1){
		k_msleep(50);
		// We check if we are blowing
		int isBlowing;
		isBlowing = blowingOnOff(reference);

		if(isBlowing){
			// If we are blowing, we get the old combination of buttons, then the new
			int oldCombination = currentlyPlaying.buttons; 
			uint8_t newCombination;
			newCombination = getCombination();


			if (oldCombination != newCombination){ 
			
				/*
				If the combination changed since the last note played 
				(takes into account the case where we were not playing beforehand)
				*/

				/*We need to stop playing the current note if we are playing one*/

				if (currentlyPlaying.on){ 
					// If we were playing a note, we stop playing it

					currentlyPlaying.on = 0;

					sendNote(0, currentlyPlaying.note, currentlyPlaying.strength);
				}

				// Now that we stopped playing the note, we can play the new one

				uint8_t newNote;
				newNote = combinationToMidi(newCombination);

				currentlyPlaying.buttons = newCombination;
				currentlyPlaying.note = newNote;
				currentlyPlaying.strength = 127;
				currentlyPlaying.on = 1;

				sendNote(1, currentlyPlaying.note, currentlyPlaying.strength);

			}

		}

		else {

			// If we are not blowing, we stop playing the note
			if (currentlyPlaying.on){ 
					// If we were playing a note, we stop playing it

					/*modification de currentlyPlaying pour éviter des problèmes :
					on n'est rien en train de jouer, donc on indique avec on=0 et buttons=-1*/
					currentlyPlaying.on = 0;
					currentlyPlaying.buttons = -1;

					sendNote(0, currentlyPlaying.note, currentlyPlaying.strength);
				}
		}
	}
}
```
