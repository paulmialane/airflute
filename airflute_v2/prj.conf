## prj.conf
```kconfig
CONFIG_PRINTK=y
CONFIG_HEAP_MEM_POOL_SIZE=256
CONFIG_ASSERT=y
CONFIG_GPIO=y
CONFIG_ADC=y
CONFIG_I2C=y

CONFIG_BOOT_DELAY=5000
CONFIG_BT=y
CONFIG_BT_PERIPHERAL=y
CONFIG_BT_DEVICE_NAME="Airflute"
# CONFIG_BT_DEBUG_LOG=y

CONFIG_BLE_MIDI=y

CONFIG_LOG=y
CONFIG_BLE_MIDI_LOG_LEVEL_INF=y

# Request a large MTU to reduce the risk of
# dropped data when sending lots of MIDI messages at once.
# Also increases streaming sysex throughput.
# https://docs.zephyrproject.org/latest/samples/bluetooth/mtu_update/README.html
CONFIG_BT_L2CAP_TX_MTU=247
CONFIG_BT_BUF_ACL_TX_SIZE=251
CONFIG_BT_BUF_ACL_RX_SIZE=251
CONFIG_BLE_MIDI_TX_PACKET_MAX_SIZE=244

CONFIG_RING_BUFFER=y

# CONFIG_BLE_MIDI_TX_MODE_SINGLE_MSG=y
# CONFIG_BLE_MIDI_TX_MODE_MANUAL=y
# CONFIG_BLE_MIDI_TX_MODE_NRF_RADIO_NOTIF=y

# CONFIG_ASSERT=y
# CONFIG_DEBUG_OPTIMIZATIONS=y
# CONFIG_DEBUG_THREAD_INFO=y
CONFIG_BT_SMP=y
CONFIG_BT_SMP_ALLOW_UNAUTH_OVERWRITE=y
```

## src/main.c
```c
/*
 * MIT License
 * 
 * Copyright (c) 2024 Paul MIALANE, Lucas MICHEL, Justine OGER
 * 
 * Permission is hereby granted, free of charge, to any person obtaining a copy
 * of this software and associated documentation files (the "Software"), to deal
 * in the Software without restriction, including without limitation the rights
 * to use, copy, modify, merge, publish, distribute, sublicense, and/or sell
 * copies of the Software, and to permit persons to whom the Software is
 * furnished to do so, subject to the following conditions:
 * 
 * The above copyright notice and this permission notice shall be included in all
 * copies or substantial portions of the Software.
 * 
 * THE SOFTWARE IS PROVIDED "AS IS", WITHOUT WARRANTY OF ANY KIND, EXPRESS OR
 * IMPLIED, INCLUDING BUT NOT LIMITED TO THE WARRANTIES OF MERCHANTABILITY,
 * FITNESS FOR A PARTICULAR PURPOSE AND NONINFRINGEMENT. IN NO EVENT SHALL THE
 * AUTHORS OR COPYRIGHT HOLDERS BE LIABLE FOR ANY CLAIM, DAMAGES OR OTHER
 * LIABILITY, WHETHER IN AN ACTION OF CONTRACT, TORT OR OTHERWISE, ARISING FROM,
 * OUT OF OR IN CONNECTION WITH THE SOFTWARE OR THE USE OR OTHER DEALINGS IN THE
 * SOFTWARE.
 */

#include <zephyr/kernel.h>
#include <zephyr/device.h>
#include <zephyr/drivers/gpio.h>
#include <zephyr/sys/printk.h>
#include <zephyr/sys/__assert.h>


#include "blinkLed.h"
#include "mainCycle.h"

#define STACKSIZE 1024
#define PRIORITY 4

void mainCycleInit(){
    // Here we initialize the main thread

    mainCycleThread();
}
 


// A thread to blink the led as it is usefull to know if the board is still alive
K_THREAD_DEFINE(blinkId, STACKSIZE, blink, NULL, NULL, NULL, PRIORITY, 0, 0);

K_THREAD_DEFINE(mainId, STACKSIZE, mainCycleInit, NULL, NULL, NULL, PRIORITY, 0, 0);
```

## src/blinkLed.c
```c
/*
 * MIT License
 * 
 * Copyright (c) 2024 Justine OGER, Lucas MICHEL, Paul MIALANE
 * 
 * Permission is hereby granted, free of charge, to any person obtaining a copy
 * of this software and associated documentation files (the "Software"), to deal
 * in the Software without restriction, including without limitation the rights
 * to use, copy, modify, merge, publish, distribute, sublicense, and/or sell
 * copies of the Software, and to permit persons to whom the Software is
 * furnished to do so, subject to the following conditions:
 * 
 * The above copyright notice and this permission notice shall be included in all
 * copies or substantial portions of the Software.
 * 
 * THE SOFTWARE IS PROVIDED "AS IS", WITHOUT WARRANTY OF ANY KIND, EXPRESS OR
 * IMPLIED, INCLUDING BUT NOT LIMITED TO THE WARRANTIES OF MERCHANTABILITY,
 * FITNESS FOR A PARTICULAR PURPOSE AND NONINFRINGEMENT. IN NO EVENT SHALL THE
 * AUTHORS OR COPYRIGHT HOLDERS BE LIABLE FOR ANY CLAIM, DAMAGES OR OTHER
 * LIABILITY, WHETHER IN AN ACTION OF CONTRACT, TORT OR OTHERWISE, ARISING FROM,
 * OUT OF OR IN CONNECTION WITH THE SOFTWARE OR THE USE OR OTHER DEALINGS IN THE
 * SOFTWARE.
 */

#include <stdbool.h>
#include <zephyr/kernel.h>
#include <zephyr/device.h>
#include <zephyr/drivers/gpio.h>

#include "blinkLed.h"


///////////////////////////////blinking a led to be sure it's alive////////////////////////////////////////////////

/* 1000 ms = 1 s */
#define SLEEP_TIME_MS   1000

/* The devicetree node identifier for the "led0" alias. */
#define LED0_NODE DT_ALIAS(led0)

/*
 * A build error on this line means your board is unsupported.
 */
static const struct gpio_dt_spec led = GPIO_DT_SPEC_GET(LED0_NODE, gpios);



void blink(void)
{
	int ret;
	bool led_state = true;

	if (!gpio_is_ready_dt(&led)) {
	}

	ret = gpio_pin_configure_dt(&led, GPIO_OUTPUT_ACTIVE);
	if (ret < 0) {
	}

	while (1) {
		ret = gpio_pin_toggle_dt(&led);
		if (ret < 0) {
		}

		led_state = !led_state;
		k_msleep(SLEEP_TIME_MS);
	}
}
```

## src/blinkLed.h
```c
/*
 * MIT License
 * 
 * Copyright (c) 2024 Paul MIALANE, Lucas MICHEL, Justine OGER
 * 
 * Permission is hereby granted, free of charge, to any person obtaining a copy
 * of this software and associated documentation files (the "Software"), to deal
 * in the Software without restriction, including without limitation the rights
 * to use, copy, modify, merge, publish, distribute, sublicense, and/or sell
 * copies of the Software, and to permit persons to whom the Software is
 * furnished to do so, subject to the following conditions:
 * 
 * The above copyright notice and this permission notice shall be included in all
 * copies or substantial portions of the Software.
 * 
 * THE SOFTWARE IS PROVIDED "AS IS", WITHOUT WARRANTY OF ANY KIND, EXPRESS OR
 * IMPLIED, INCLUDING BUT NOT LIMITED TO THE WARRANTIES OF MERCHANTABILITY,
 * FITNESS FOR A PARTICULAR PURPOSE AND NONINFRINGEMENT. IN NO EVENT SHALL THE
 * AUTHORS OR COPYRIGHT HOLDERS BE LIABLE FOR ANY CLAIM, DAMAGES OR OTHER
 * LIABILITY, WHETHER IN AN ACTION OF CONTRACT, TORT OR OTHERWISE, ARISING FROM,
 * OUT OF OR IN CONNECTION WITH THE SOFTWARE OR THE USE OR OTHER DEALINGS IN THE
 * SOFTWARE.
 */

void blink(void);
```

## src/blowSensor.c
```c
/*
 * MIT License
 * 
 * Copyright (c) 2024 Justine OGER, Lucas MICHEL, Paul MIALANE
 * 
 * Permission is hereby granted, free of charge, to any person obtaining a copy
 * of this software and associated documentation files (the "Software"), to deal
 * in the Software without restriction, including without limitation the rights
 * to use, copy, modify, merge, publish, distribute, sublicense, and/or sell
 * copies of the Software, and to permit persons to whom the Software is
 * furnished to do so, subject to the following conditions:
 * 
 * The above copyright notice and this permission notice shall be included in all
 * copies or substantial portions of the Software.
 * 
 * THE SOFTWARE IS PROVIDED "AS IS", WITHOUT WARRANTY OF ANY KIND, EXPRESS OR
 * IMPLIED, INCLUDING BUT NOT LIMITED TO THE WARRANTIES OF MERCHANTABILITY,
 * FITNESS FOR A PARTICULAR PURPOSE AND NONINFRINGEMENT. IN NO EVENT SHALL THE
 * AUTHORS OR COPYRIGHT HOLDERS BE LIABLE FOR ANY CLAIM, DAMAGES OR OTHER
 * LIABILITY, WHETHER IN AN ACTION OF CONTRACT, TORT OR OTHERWISE, ARISING FROM,
 * OUT OF OR IN CONNECTION WITH THE SOFTWARE OR THE USE OR OTHER DEALINGS IN THE
 * SOFTWARE.
 */


#include <stdio.h>
#include <zephyr/kernel.h>
#include <zephyr/drivers/gpio.h>
#include <zephyr/drivers/adc.h>
#include <math.h>

#include "blowSensor.h"

static const struct adc_dt_spec adc_a0 =  ADC_DT_SPEC_GET_BY_IDX(DT_PATH(zephyr_user), 0);

int sensor_threshold = 35;

// une seule donnée de 16bits
int16_t buf = 33;
struct adc_sequence sequence = {
	.buffer = &buf,
	/* buffer size in bytes, not number of samples */
	.buffer_size = sizeof(buf),
	//Optional
	//.calibrate = true,
};


int sensorInit(void) {
	int err1;

	// Configure the button pin as input
	if(adc_is_ready_dt(&adc_a0)) {
		printf("ADC is ready\n");
	} else {
		printf("ADC is NOT ready\n");
	}

	err1 = adc_channel_setup_dt(&adc_a0);
	if (err1 < 0) {
		printk("Error in ADC setup (%d)\n", err1);
		return err1;
	}

	err1 = adc_sequence_init_dt(&adc_a0, &sequence);
	if (err1 < 0) {
		printk("Error in the ADC sequence initialization (%d)\n", err1);
		return err1;
	}

	int mean=0;
	int length = 100;
	for (int i=0; i<length-1; i++) {
		err1 = adc_read(adc_a0.dev, &sequence);
		mean += buf; 
		k_msleep(10);
	}

	const int standard = (int) mean/length;
	printk("Sensor initialized with standard value %i\n", standard);

	return standard;
}

int filter(int data, int standard) {
	//pas mal de travail ici
	if (data > standard - sensor_threshold) {
		return 0;
	} else if (standard - data - sensor_threshold > 127) {
		return 127;
	}

	return standard - data - sensor_threshold;
}







/// fonctions

int blowingOnOff(int standard){

	int err;
	err = adc_read(adc_a0.dev, &sequence);

	int data_out = 0;
	if (err < 0) {
		printk("Error reading the ADC (#%d)", err);
	}
	else {
		data_out = filter(buf, standard);
		if (data_out) {
			return 1;
		} else {
			return 0;
		}
	}
}

int blowingStrength(int standard){
	int err;
	err = adc_read(adc_a0.dev, &sequence);

	int data_out = 0;
	if (err < 0) {
		printk("Error reading the ADC (#%d)", err);
	}
	else {
		data_out = filter(buf, standard);
	}

	return data_out;
}

int strengthCategory(int strength){
	int category;
	if (strength < 60){
		return 50;
	}
	else{
		if(strength < 100){
			return 90;
		}
		else{
			return 120;
		}
	}
}
```

## src/blowSensor.h
```c
/*
 * MIT License
 * 
 * Copyright (c) 2024 Justine OGER, Lucas MICHEL, Paul MIALANE
 * 
 * Permission is hereby granted, free of charge, to any person obtaining a copy
 * of this software and associated documentation files (the "Software"), to deal
 * in the Software without restriction, including without limitation the rights
 * to use, copy, modify, merge, publish, distribute, sublicense, and/or sell
 * copies of the Software, and to permit persons to whom the Software is
 * furnished to do so, subject to the following conditions:
 * 
 * The above copyright notice and this permission notice shall be included in all
 * copies or substantial portions of the Software.
 * 
 * THE SOFTWARE IS PROVIDED "AS IS", WITHOUT WARRANTY OF ANY KIND, EXPRESS OR
 * IMPLIED, INCLUDING BUT NOT LIMITED TO THE WARRANTIES OF MERCHANTABILITY,
 * FITNESS FOR A PARTICULAR PURPOSE AND NONINFRINGEMENT. IN NO EVENT SHALL THE
 * AUTHORS OR COPYRIGHT HOLDERS BE LIABLE FOR ANY CLAIM, DAMAGES OR OTHER
 * LIABILITY, WHETHER IN AN ACTION OF CONTRACT, TORT OR OTHERWISE, ARISING FROM,
 * OUT OF OR IN CONNECTION WITH THE SOFTWARE OR THE USE OR OTHER DEALINGS IN THE
 * SOFTWARE.
 */

#ifndef BLOWSENSOR_H
#define BLOWSENSOR_H

#include <stdint.h>
#include <stdbool.h>

int sensorInit(void);
bool blowingOnOff(int);
uint8_t blowingStrength(int);
uint8_t strengthCategory(uint8_t);

#endif
```

## src/bluetoothThread.c
```c
/*
 * MIT License
 * 
 * Copyright (c) 2024 Justine OGER, Lucas MICHEL, Paul MIALANE
 * 
 * Permission is hereby granted, free of charge, to any person obtaining a copy
 * of this software and associated documentation files (the "Software"), to deal
 * in the Software without restriction, including without limitation the rights
 * to use, copy, modify, merge, publish, distribute, sublicense, and/or sell
 * copies of the Software, and to permit persons to whom the Software is
 * furnished to do so, subject to the following conditions:
 * 
 * The above copyright notice and this permission notice shall be included in all
 * copies or substantial portions of the Software.
 * 
 * THE SOFTWARE IS PROVIDED "AS IS", WITHOUT WARRANTY OF ANY KIND, EXPRESS OR
 * IMPLIED, INCLUDING BUT NOT LIMITED TO THE WARRANTIES OF MERCHANTABILITY,
 * FITNESS FOR A PARTICULAR PURPOSE AND NONINFRINGEMENT. IN NO EVENT SHALL THE
 * AUTHORS OR COPYRIGHT HOLDERS BE LIABLE FOR ANY CLAIM, DAMAGES OR OTHER
 * LIABILITY, WHETHER IN AN ACTION OF CONTRACT, TORT OR OTHERWISE, ARISING FROM,
 * OUT OF OR IN CONNECTION WITH THE SOFTWARE OR THE USE OR OTHER DEALINGS IN THE
 * SOFTWARE.
 */


#include <zephyr/kernel.h>
#include <zephyr/device.h>
#include <zephyr/drivers/gpio.h>
#include <zephyr/sys/printk.h>
#include <zephyr/sys/__assert.h>

#include "dataType.h"
#include "playSingleNote.h"
#include "bluetoothThread.h"

int bluetoothThread(struct k_fifo* noteToPlayFifo) {

	/*
	 * This function is running in a separated thread
	 * and simply handles the bluetooth logic of the program
	 *
	 * It waits for a bluetooth connection to be established,
	 * pulls data from the Fifo, and send it to 
	 * the bluetooth receptor
	 */ 

	midiInitialize();
	printk("----------------\nMidi initialized\n----------------\n\n");

	while(1) {
		/*
		 * Whether we are connected to a device or not, we 
		 * pull the note from the fifo to avoid to flood
		 * the fifo with notes to play while waiting
		 * for a connection.
		 */ 

		struct note_data *rx_data = k_fifo_get(noteToPlayFifo, K_FOREVER);

		if (isConnectedOverBLE()) {
			/* 
			 * If we are connected to a device:
			 *   - We extract the data from the structure
			 *   - We play the note
			 */
			int note = rx_data->note;
			int force = rx_data->strength;
			bool on = rx_data->on;

			sendNote(on, note, force);
		} else {

			// If we are not connected to a device
			printk("Waiting for a connection\n");
		}

		// We free the memory
		k_free(rx_data);
		k_msleep(10);
	}
}
```

## src/bluetoothThread.h
```c
/*
 * MIT License
 * 
 * Copyright (c) 2024 Paul MIALANE, Lucas MICHEL, Justine OGER
 * 
 * Permission is hereby granted, free of charge, to any person obtaining a copy
 * of this software and associated documentation files (the "Software"), to deal
 * in the Software without restriction, including without limitation the rights
 * to use, copy, modify, merge, publish, distribute, sublicense, and/or sell
 * copies of the Software, and to permit persons to whom the Software is
 * furnished to do so, subject to the following conditions:
 * 
 * The above copyright notice and this permission notice shall be included in all
 * copies or substantial portions of the Software.
 * 
 * THE SOFTWARE IS PROVIDED "AS IS", WITHOUT WARRANTY OF ANY KIND, EXPRESS OR
 * IMPLIED, INCLUDING BUT NOT LIMITED TO THE WARRANTIES OF MERCHANTABILITY,
 * FITNESS FOR A PARTICULAR PURPOSE AND NONINFRINGEMENT. IN NO EVENT SHALL THE
 * AUTHORS OR COPYRIGHT HOLDERS BE LIABLE FOR ANY CLAIM, DAMAGES OR OTHER
 * LIABILITY, WHETHER IN AN ACTION OF CONTRACT, TORT OR OTHERWISE, ARISING FROM,
 * OUT OF OR IN CONNECTION WITH THE SOFTWARE OR THE USE OR OTHER DEALINGS IN THE
 * SOFTWARE.
 */


#include <zephyr/kernel.h>

int bluetoothThread(struct k_fifo*);
```

## src/buttonStatus.c
```c
/*
 * MIT License
 * 
 * Copyright (c) 2024 Justine OGER, Lucas MICHEL, Paul MIALANE
 * 
 * Permission is hereby granted, free of charge, to any person obtaining a copy
 * of this software and associated documentation files (the "Software"), to deal
 * in the Software without restriction, including without limitation the rights
 * to use, copy, modify, merge, publish, distribute, sublicense, and/or sell
 * copies of the Software, and to permit persons to whom the Software is
 * furnished to do so, subject to the following conditions:
 * 
 * The above copyright notice and this permission notice shall be included in all
 * copies or substantial portions of the Software.
 * 
 * THE SOFTWARE IS PROVIDED "AS IS", WITHOUT WARRANTY OF ANY KIND, EXPRESS OR
 * IMPLIED, INCLUDING BUT NOT LIMITED TO THE WARRANTIES OF MERCHANTABILITY,
 * FITNESS FOR A PARTICULAR PURPOSE AND NONINFRINGEMENT. IN NO EVENT SHALL THE
 * AUTHORS OR COPYRIGHT HOLDERS BE LIABLE FOR ANY CLAIM, DAMAGES OR OTHER
 * LIABILITY, WHETHER IN AN ACTION OF CONTRACT, TORT OR OTHERWISE, ARISING FROM,
 * OUT OF OR IN CONNECTION WITH THE SOFTWARE OR THE USE OR OTHER DEALINGS IN THE
 * SOFTWARE.
 */

#include <stdio.h>
#include <zephyr/kernel.h>
#include <zephyr/drivers/gpio.h>
#include <stdint.h>

#include "buttonStatus.h"


#define EXT_GPIO_CTRL_1 DT_NODELABEL(pcf8574_1)

// The structure to control the device
static const struct device * const ext_gpio_1 = DEVICE_DT_GET(EXT_GPIO_CTRL_1);

#define SLEEP_TIME_MS 1000

gpio_port_value_t val_gpio_1;

/* Sensors are not mapped in the same order on
 * the I2C bus and in the "natural" way.
 *
 * (Understand as : the 3rd hole on the flute isn't 
 * necessarily the 3rd sensor on the I2C bus)
 *
 * This Conversion Table offers a conveniant way
 * to convert from a view to another.
 */
static const uint8_t CT[8] = {
	(1UL<<4), // button 0
	(1UL<<5), // button 1
	(1UL<<6), // button 2
	(1UL<<0), // button 3
	(1UL<<7), // button 4
	(1UL<<1), // button 5
	(1UL<<2), // button 6
	(1UL<<3), // button 7
};

uint8_t conv(uint8_t in) {
	
	/* 
	 * Convert a combination of inputs (represented as an
	 * 8 bits unsigned integer) from the viex of the I2C bus
	 * to the natural way
	 */

	uint8_t out = 0;

	for(int i=0;i<8;i++) {
		if (in & (1UL << i)) out = out | CT[i];
	}
	return out;
}


uint8_t getCombination(void){

	/* 
	 * A function that returns the current combination of
	 * inputs on the flute
	 */

	gpio_port_get(ext_gpio_1, &val_gpio_1);
	
	// We invert the value because the button is active low
	return conv(~val_gpio_1);
}
```

## src/buttonStatus.h
```c
/*
 * MIT License
 * 
 * Copyright (c) 2024 Justine OGER, Lucas MICHEL, Paul MIALANE
 * 
 * Permission is hereby granted, free of charge, to any person obtaining a copy
 * of this software and associated documentation files (the "Software"), to deal
 * in the Software without restriction, including without limitation the rights
 * to use, copy, modify, merge, publish, distribute, sublicense, and/or sell
 * copies of the Software, and to permit persons to whom the Software is
 * furnished to do so, subject to the following conditions:
 * 
 * The above copyright notice and this permission notice shall be included in all
 * copies or substantial portions of the Software.
 * 
 * THE SOFTWARE IS PROVIDED "AS IS", WITHOUT WARRANTY OF ANY KIND, EXPRESS OR
 * IMPLIED, INCLUDING BUT NOT LIMITED TO THE WARRANTIES OF MERCHANTABILITY,
 * FITNESS FOR A PARTICULAR PURPOSE AND NONINFRINGEMENT. IN NO EVENT SHALL THE
 * AUTHORS OR COPYRIGHT HOLDERS BE LIABLE FOR ANY CLAIM, DAMAGES OR OTHER
 * LIABILITY, WHETHER IN AN ACTION OF CONTRACT, TORT OR OTHERWISE, ARISING FROM,
 * OUT OF OR IN CONNECTION WITH THE SOFTWARE OR THE USE OR OTHER DEALINGS IN THE
 * SOFTWARE.
 */

#ifndef BUTTONSTATUS_H
#define BUTTONSTATUS_H

#include <stdint.h>

uint8_t getCombination(void);

#endif
```

## src/combinationToMidi.c
```c
/*
 * MIT License
 * 
 * Copyright (c) 2024 Justine OGER, Lucas MICHEL, Paul MIALANE
 * 
 * Permission is hereby granted, free of charge, to any person obtaining a copy
 * of this software and associated documentation files (the "Software"), to deal
 * in the Software without restriction, including without limitation the rights
 * to use, copy, modify, merge, publish, distribute, sublicense, and/or sell
 * copies of the Software, and to permit persons to whom the Software is
 * furnished to do so, subject to the following conditions:
 * 
 * The above copyright notice and this permission notice shall be included in all
 * copies or substantial portions of the Software.
 * 
 * THE SOFTWARE IS PROVIDED "AS IS", WITHOUT WARRANTY OF ANY KIND, EXPRESS OR
 * IMPLIED, INCLUDING BUT NOT LIMITED TO THE WARRANTIES OF MERCHANTABILITY,
 * FITNESS FOR A PARTICULAR PURPOSE AND NONINFRINGEMENT. IN NO EVENT SHALL THE
 * AUTHORS OR COPYRIGHT HOLDERS BE LIABLE FOR ANY CLAIM, DAMAGES OR OTHER
 * LIABILITY, WHETHER IN AN ACTION OF CONTRACT, TORT OR OTHERWISE, ARISING FROM,
 * OUT OF OR IN CONNECTION WITH THE SOFTWARE OR THE USE OR OTHER DEALINGS IN THE
 * SOFTWARE.
 */

#include <stdio.h>
#include <stdint.h>
#include <stdbool.h>

#include "combinationToMidi.h"

#define NB_BUTTONS 8
#define NB_NOTES 27
// Whether we want to add or subtract an octave to the note (1/0/-1)
#define OCTAVE 0

/* Key combination definition.
 * In case we want to change the bindings, all we have to do is
 * change the following constants.
 *
 * Example:
 * If we want to change the binding of the C key to the first 4 buttons,
 * we would change the C constant to:
 *
 * const uint8_t C = (1<<0) | (1<<1) | (1<<2) | (1<<3);
 */

static const uint8_t CSharp = 0;
static const uint8_t C = (1<<1);
static const uint8_t B = 1;
static const uint8_t Bb = 1 | (1<<3);
static const uint8_t ASharp = 1 | (1<<1) | (1<<3);
static const uint8_t A = 1 | (1<<1);
static const uint8_t GSharp = 1 | (1<<1) | (1<<2) | (1<<3);
static const uint8_t G = 1 | (1<<1) | (1<<2);
static const uint8_t FSharp = 1 | (1<<1) | (1<<2) | (1<<5);
static const uint8_t F = 1 | (1<<1) | (1<<2) | (1<<4);
static const uint8_t E = 1 | (1<<1) | (1<<2) | (1<<4) | (1<<5);
static const uint8_t DSharp = 1 | (1<<1) | (1<<2) | (1<<3) | (1<<4) | (1<<5) | (1<<6);
static const uint8_t D = 1 | (1<<1) | (1<<2) | (1<<4) | (1<<5) | (1<<6);
static const uint8_t CSharpPlus = CSharp | (1<<7);
static const uint8_t CPlus = C | (1<<7);
static const uint8_t BPlus = B | (1<<7);
static const uint8_t BbPlus = Bb | (1<<7);
static const uint8_t ASharpPlus = ASharp | (1<<7);
static const uint8_t APlus = A | (1<<7);
static const uint8_t GSharpPlus = GSharp | (1<<7);
static const uint8_t GPlus = G | (1<<7);
static const uint8_t FSharpPlus = FSharp | (1<<7);
static const uint8_t FPlus = F | (1<<7);
static const uint8_t EPlus = E | (1<<7);
static const uint8_t DSharpPlus = DSharp | (1<<7);
static const uint8_t DPlus = D | (1<<7);
static const uint8_t DPlusPlus = (1<<1) | (1<<2) | (1<<7);

/* 
 * A structure to hold the note information.
 * A note is defined by a key mask, a MIDI pitch and a name.
 * The key mask is a bit mask that represents the keys that are pressed.
 * The MIDI pitch is the MIDI pitch of the note according 
 * to the MIDI standard. The name is the name of the note.
 *
 * Example:
 * The C note is defined by the following:
 *       
 *       keyMask = 0b00000010
 *       midiPitch = 72
 *       name = "C"
 */

typedef struct {
    uint8_t keyMask;
    uint8_t midiPitch;
    char *name;
} note_t;


/* 
 * Macro to initialize a note
 * This macro is used to initialize a note structure. 
 * It takes 3 arguments:
 * 	- k: the key mask
 * 	- m: the MIDI pitch
 * 	- n: the name of the note
 *
 * In case the midiPitch is greater than 127, it will 
 * be truncated to 127.
 *
 * Example: To initialize the C note, we would use the following:
 *
 * NOTE_INIT(C, 72, "C")
 */

#define NOTE_INIT(k, m, n) {.keyMask=k, .midiPitch=((m)&(0xff)), .name=n}

static const note_t noteArray[NB_NOTES] = {
    NOTE_INIT(CSharp, 73+OCTAVE*12, "C#"),
    NOTE_INIT(C, 72+OCTAVE*12, "C"),
    NOTE_INIT(B, 71+OCTAVE*12, "B"),
    NOTE_INIT(Bb, 70+OCTAVE*12, "Bb"),
    NOTE_INIT(ASharp, 70+OCTAVE*12, "A#"),
    NOTE_INIT(A, 69+OCTAVE*12, "A"),
    NOTE_INIT(GSharp, 68+OCTAVE*12, "G#"),
    NOTE_INIT(G, 67+OCTAVE*12, "G"),
    NOTE_INIT(FSharp, 66+OCTAVE*12, "F#"),
    NOTE_INIT(F, 65+OCTAVE*12, "F"),
    NOTE_INIT(E, 64+OCTAVE*12, "E"),
    NOTE_INIT(DSharp, 63+OCTAVE*12, "D#"),
    NOTE_INIT(D, 62+OCTAVE*12, "D"),
    NOTE_INIT(CSharpPlus, 85+OCTAVE*12, "+C#"),
    NOTE_INIT(CPlus, 84+OCTAVE*12, "+C"),
    NOTE_INIT(BPlus, 83+OCTAVE*12, "+B"),
    NOTE_INIT(BbPlus, 82+OCTAVE*12, "+Bb"),
    NOTE_INIT(ASharpPlus, 82+OCTAVE*12, "+A#"),
    NOTE_INIT(APlus, 81+OCTAVE*12, "+A"),
    NOTE_INIT(GSharpPlus, 80+OCTAVE*12, "+G#"),
    NOTE_INIT(GPlus, 79+OCTAVE*12, "+G"),
    NOTE_INIT(FSharpPlus, 78+OCTAVE*12, "+F#"),
    NOTE_INIT(FPlus, 77+OCTAVE*12, "+F"),
    NOTE_INIT(EPlus, 76+OCTAVE*12, "+E"),
    NOTE_INIT(DSharpPlus, 75+OCTAVE*12, "+D#"),
    NOTE_INIT(DPlus, 74+OCTAVE*12, "+D"),
    NOTE_INIT(DPlusPlus, 86+OCTAVE*12, "++D")
};


uint8_t combinationToMidi(uint8_t sensorValues) {
    /*
	 * This function takes the sensor values and 
	 * returns the MIDI pitch of the note that corresponds
	 * to the sensor values.
	 *
	 * If the sensor values do not correspond to any note, 
	 * the function looks for a close key combination. 
	 * If none is found, it returns 127.
     */

    for (int i = 0; i < NB_NOTES; i++) {
        if (noteArray[i].keyMask == sensorValues) {
            return noteArray[i].midiPitch;
        }
    }

	// TODO : Find a way to activate or not the correction
    /*for (int i = 0; i < NB_NOTES; i++) {
        if (hammingDistance(sensorValues, noteArray[i].keyMask) == 1) {
            return noteArray[i].midiPitch;
        }
    }
    for (int i = 0; i < NB_NOTES; i++) {
        if (hammingDistance(sensorValues, noteArray[i].keyMask) == 2) {
            return noteArray[i].midiPitch;
        }
    }*/
    return 127;
}

const char * fromSensorToPitchName(uint8_t sensorValues) {
    /*
	 * This function takes the sensor values and returns 
	 * the name of the note that corresponds to 
	 * the sensor values.
	 *
	 * If the sensor values do not correspond to any note, 
	 * the function looks for a close key combination.
	 * If none is found, it returns "not a note".
     */
    for (int i = 0; i < NB_NOTES; i++) {
        if (noteArray[i].keyMask == sensorValues) {
            return noteArray[i].name;
        }
    }

	// TODO : See previous TODO
    /*for (int i = 0; i < NB_NOTES; i++) {
        if (hammingDistance(sensorValues, noteArray[i].keyMask) == 1) {
            return noteArray[i].midiPitch;
        }
    }
    for (int i = 0; i < NB_NOTES; i++) {
        if (hammingDistance(sensorValues, noteArray[i].keyMask) == 2) {
            return noteArray[i].midiPitch;
        }
    }*/
    return "not a note";
}


uint8_t hammingDistance(uint8_t a, uint8_t b) {
    /*
	 * This function calculates the Hamming 
	 * distance between two numbers.
	 *
	 * The Hamming distance is the number of positions 
	 * at which the corresponding bits are different.
	 *
     * Example:
     * The Hamming distance between 0b1010 and 0b1001 is 2.
     */

    uint8_t distance = 0;
    uint8_t c = a ^ b;
    while (c) {
        distance++;
        c &= c - 1;
    }
    return distance;
}
```

## src/combinationToMidi.h
```c
/*
 * MIT License
 * 
 * Copyright (c) 2024 Justine OGER, Lucas MICHEL, Paul MIALANE
 * 
 * Permission is hereby granted, free of charge, to any person obtaining a copy
 * of this software and associated documentation files (the "Software"), to deal
 * in the Software without restriction, including without limitation the rights
 * to use, copy, modify, merge, publish, distribute, sublicense, and/or sell
 * copies of the Software, and to permit persons to whom the Software is
 * furnished to do so, subject to the following conditions:
 * 
 * The above copyright notice and this permission notice shall be included in all
 * copies or substantial portions of the Software.
 * 
 * THE SOFTWARE IS PROVIDED "AS IS", WITHOUT WARRANTY OF ANY KIND, EXPRESS OR
 * IMPLIED, INCLUDING BUT NOT LIMITED TO THE WARRANTIES OF MERCHANTABILITY,
 * FITNESS FOR A PARTICULAR PURPOSE AND NONINFRINGEMENT. IN NO EVENT SHALL THE
 * AUTHORS OR COPYRIGHT HOLDERS BE LIABLE FOR ANY CLAIM, DAMAGES OR OTHER
 * LIABILITY, WHETHER IN AN ACTION OF CONTRACT, TORT OR OTHERWISE, ARISING FROM,
 * OUT OF OR IN CONNECTION WITH THE SOFTWARE OR THE USE OR OTHER DEALINGS IN THE
 * SOFTWARE.
 */

#ifndef COMBINATIONTOMIDI_H
#define COMBINATIONTOMIDI_H

#include <stdint.h>

uint8_t combinationToMidi(uint8_t sensorValues);
int hammingDistance(uint8_t a, uint8_t b);

#endif
```

## src/dataType.h
```c
/*
 * MIT License
 * 
 * Copyright (c) 2024 Justine OGER, Lucas MICHEL, Paul MIALANE
 * 
 * Permission is hereby granted, free of charge, to any person obtaining a copy
 * of this software and associated documentation files (the "Software"), to deal
 * in the Software without restriction, including without limitation the rights
 * to use, copy, modify, merge, publish, distribute, sublicense, and/or sell
 * copies of the Software, and to permit persons to whom the Software is
 * furnished to do so, subject to the following conditions:
 * 
 * The above copyright notice and this permission notice shall be included in all
 * copies or substantial portions of the Software.
 * 
 * THE SOFTWARE IS PROVIDED "AS IS", WITHOUT WARRANTY OF ANY KIND, EXPRESS OR
 * IMPLIED, INCLUDING BUT NOT LIMITED TO THE WARRANTIES OF MERCHANTABILITY,
 * FITNESS FOR A PARTICULAR PURPOSE AND NONINFRINGEMENT. IN NO EVENT SHALL THE
 * AUTHORS OR COPYRIGHT HOLDERS BE LIABLE FOR ANY CLAIM, DAMAGES OR OTHER
 * LIABILITY, WHETHER IN AN ACTION OF CONTRACT, TORT OR OTHERWISE, ARISING FROM,
 * OUT OF OR IN CONNECTION WITH THE SOFTWARE OR THE USE OR OTHER DEALINGS IN THE
 * SOFTWARE.
 */

#ifndef DATATYPE_H
#define DATATYPE_H

#include <stdbool.h>

/* This is a structure to hold the informations
 * about a note in the fifo while it waits to 
 * be processed
 */

struct note_data {
	void *fifo_reserved; /* 1st word reserved for use by fifo */
	int buttons;
	int strength;
	int note;
	bool on;
};

#endif
```

## src/mainCycle.c
```c
/*
 * MIT License
 * 
 * Copyright (c) 2024 Justine OGER, Lucas MICHEL, Paul MIALANE
 * 
 * Permission is hereby granted, free of charge, to any person obtaining a copy
 * of this software and associated documentation files (the "Software"), to deal
 * in the Software without restriction, including without limitation the rights
 * to use, copy, modify, merge, publish, distribute, sublicense, and/or sell
 * copies of the Software, and to permit persons to whom the Software is
 * furnished to do so, subject to the following conditions:
 * 
 * The above copyright notice and this permission notice shall be included in all
 * copies or substantial portions of the Software.
 * 
 * THE SOFTWARE IS PROVIDED "AS IS", WITHOUT WARRANTY OF ANY KIND, EXPRESS OR
 * IMPLIED, INCLUDING BUT NOT LIMITED TO THE WARRANTIES OF MERCHANTABILITY,
 * FITNESS FOR A PARTICULAR PURPOSE AND NONINFRINGEMENT. IN NO EVENT SHALL THE
 * AUTHORS OR COPYRIGHT HOLDERS BE LIABLE FOR ANY CLAIM, DAMAGES OR OTHER
 * LIABILITY, WHETHER IN AN ACTION OF CONTRACT, TORT OR OTHERWISE, ARISING FROM,
 * OUT OF OR IN CONNECTION WITH THE SOFTWARE OR THE USE OR OTHER DEALINGS IN THE
 * SOFTWARE.
 */

#include <zephyr/kernel.h>
#include <zephyr/device.h>
#include <zephyr/drivers/gpio.h>
#include <zephyr/sys/printk.h>
#include <zephyr/sys/__assert.h>
#include <stdbool.h>
#include <stdint.h>

#include "dataType.h"
#include "mainCycle.h"
#include "blowSensor.h"
#include "buttonStatus.h"
#include "combinationToMidi.h"
#include "playSingleNote.h"


void mainCycleThread(){

	/*
	 * This thread handles the logic of the flute
	 */

	int standard = sensorInit();

	midiInitialize();
	printk("----------------\nMidi initialized\n----------------\n\n");

	/*
	 * Initialization of the "note we are currently playing" 
	 * (except we are not playing anything at the beginning, so
	 * we use impossible values)
	 */

	struct note_data currentlyPlaying = {.buttons = 0, .note = 255, .on = 0, .strength = 255};

	while(1) {
		// We wait 50ms before looking for a change.
		k_msleep(50);

		bool isBlowing = blowingOnOff(standard);

		if(isBlowing && currentlyPlaying.on) {
			/*
			 * If we are blowing, we get the old combination
			 * of buttons, then the new and the old strength
			 */

			uint8_t oldCombination = currentlyPlaying.buttons; 
			uint8_t newCombination = getCombination();
			uint8_t oldStrength = currentlyPlaying.strength;
			uint8_t newStrength = strengthCategory(blowingStrength(standard));


			if (oldCombination != newCombination) { 
				/*
				 * If the combination changed since the last
				 * note played
				 */

				// We stop playing the current note if we are playing
				sendNote(false, currentlyPlaying.note, currentlyPlaying.strength);

				// Now that we stopped the note, we play the new one
				uint8_t newNote = combinationToMidi(newCombination);
				currentlyPlaying.buttons = newCombination;
				currentlyPlaying.note = newNote;
				currentlyPlaying.strength = newStrength;

				sendNote(currentlyPlaying.on, currentlyPlaying.note, currentlyPlaying.strength);

			}

			else {
				/*
				 * if the combination didn't change, we have
				 * to check if we started blowing with a 
				 * different strength (so if we have to change
				 * the volume)
				 */

				if (newStrength != oldStrength) {
					/*
					 * For now, we are trying to
					 * just send the same note with a different volume
					 * (without sending a note off first)
					 */
					currentlyPlaying.strength = newStrength;

					sendNote(false, currentlyPlaying.note, currentlyPlaying.strength);

					sendNote(currentlyPlaying.on, currentlyPlaying.note, currentlyPlaying.strength);
				}
			}

		} else if(isBlowing && (!currentlyPlaying.on)) {
			
			/*
			 * If we are blowing but were not already playing a note
			 */

			uint8_t newCombination = getCombination();
			uint8_t newStrength = strengthCategory(blowingStrength(standard));
			uint8_t	newNote = combinationToMidi(newCombination);

			currentlyPlaying.buttons = newCombination;
			currentlyPlaying.note = newNote;
			currentlyPlaying.on = true;
			currentlyPlaying.strength = newStrength;

			sendNote(true, currentlyPlaying.note, currentlyPlaying.strength);

		} else {

			// If we are not blowing, we stop playing the note
			if (currentlyPlaying.on) { 

				sendNote(false, currentlyPlaying.note,
						currentlyPlaying.strength);

			}

			currentlyPlaying.on = false;
		}
	}
}
```
