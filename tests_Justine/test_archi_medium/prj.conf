## prj.conf
```kconfig
CONFIG_PRINTK=y
CONFIG_HEAP_MEM_POOL_SIZE=256
CONFIG_ASSERT=y
CONFIG_GPIO=y

CONFIG_BOOT_DELAY=5000
CONFIG_BT=y
CONFIG_BT_PERIPHERAL=y
CONFIG_BT_DEVICE_NAME="zephyr-ble-midi-Juju"
# CONFIG_BT_DEBUG_LOG=y

CONFIG_BLE_MIDI=y

CONFIG_LOG=y
CONFIG_BLE_MIDI_LOG_LEVEL_INF=y

# Request a large MTU to reduce the risk of
# dropped data when sending lots of MIDI messages at once.
# Also increases streaming sysex throughput.
# https://docs.zephyrproject.org/latest/samples/bluetooth/mtu_update/README.html
CONFIG_BT_L2CAP_TX_MTU=247
CONFIG_BT_BUF_ACL_TX_SIZE=251
CONFIG_BT_BUF_ACL_RX_SIZE=251
CONFIG_BLE_MIDI_TX_PACKET_MAX_SIZE=244

CONFIG_RING_BUFFER=y

# CONFIG_BLE_MIDI_TX_MODE_SINGLE_MSG=y
# CONFIG_BLE_MIDI_TX_MODE_MANUAL=y
# CONFIG_BLE_MIDI_TX_MODE_NRF_RADIO_NOTIF=y

# CONFIG_ASSERT=y
# CONFIG_DEBUG_OPTIMIZATIONS=y
# CONFIG_DEBUG_THREAD_INFO=y
CONFIG_BT_SMP=y
CONFIG_BT_SMP_ALLOW_UNAUTH_OVERWRITE=y
```

## src/main.c
```c
#include <zephyr/kernel.h>
#include <zephyr/device.h>
#include <zephyr/drivers/gpio.h>
#include <zephyr/sys/printk.h>
#include <zephyr/sys/__assert.h>


#include "blinkLed.h"
#include "mainCycle.h"
#include "bluetoothThread.h"

#define STACKSIZE 1024
#define PRIORITY 4

K_FIFO_DEFINE(noteToPlayFifo);

void bluetoothThreadInit(){
    // Here we initialize the bluetooth thread

    bluetoothThread(&noteToPlayFifo);
}

void mainCycleInit(){
    // Here we initialize the main thread

    mainCycleThread(&noteToPlayFifo);
}
 


// A thread to blink the led as it is usefull to know if the board is still alive
K_THREAD_DEFINE(blinkId, STACKSIZE, blink, NULL, NULL, NULL, PRIORITY, 0, 0);
K_THREAD_DEFINE(bluetoothId, STACKSIZE, bluetoothThreadInit, NULL, NULL, NULL, PRIORITY, 0, 0);
K_THREAD_DEFINE(mainId, STACKSIZE, mainCycleInit, NULL, NULL, NULL, PRIORITY, 0, 0);
```

## src/buttonStatus.h
```c
int getCombination(void);
```

## src/mainCycle.c
```c
#include <zephyr/kernel.h>
#include <zephyr/device.h>
#include <zephyr/drivers/gpio.h>
#include <zephyr/sys/printk.h>
#include <zephyr/sys/__assert.h>

#include "dataType.h"
#include "mainCycle.h"
#include "blowCaptor.h"
#include "buttonStatus.h"
#include "combinationToMidi.h"
#include "playSingleNote.h"


void mainCycleThread(k_fifo* noteToPlayFifo){

	midiInitialize();
	printk("------------------\nMidi initialisé\n------------------\n\n");

	struct note_data currentlyPlaying = {.buttons = -1, .note = -1, .on = 0, .strength = 0};
	/*
	Initialization of the "note we are currently playing" 
	(except we are not playing anything at the beginning, so we use impossible values)
	*/

	while(1){
		k_msleep(500);
		// We check if we are blowing
		int isBlowing;
		isBlowing = blowingOnOff();
		printk("Est-ce qu'on souffle : %d\n", isBlowing);

		if(isBlowing){
			// If we are blowing, we get the old combination of buttons, then the new
			int oldCombination = currentlyPlaying.buttons; 
			int newCombination;
			newCombination = getCombination();

			printk("Capteurs doigts récupérés\n");


			if (oldCombination != newCombination){ 
			
				/*
				If the combination changed since the last note played 
				(takes into account the case where we were not playing beforehand)
				*/

			    printk("On a changé de note\n");

				/*We need to stop playing the current note if we are playing one*/

				if (currentlyPlaying.on){ 
					// If we were playing a note, we stop playing it

					currentlyPlaying.on = 0;

					struct note_data tx_data = {.buttons = {}, .strength = force , .note = note, .on = 1};

					copyArray(tx_data.buttons, combinaison);
					
					// This SHOULD BE unnecessary
					size_t size = sizeof(struct note_data);
					struct note_data *mem_ptr = k_malloc(size);
					__ASSERT_NO_MSG(mem_ptr != 0);

					memcpy(mem_ptr, &tx_data, size);
				}

				// Now that we stopped playing the note, we can play the new one

				int newNote;
				newNote = toMidi(newCombination);

				currentlyPlaying.buttons = newCombination;
				currentlyPlaying.note = newNote;
				currentlyPlaying.strength = 127;
				currentlyPlaying.on = 1;

				sendNote(1, currentlyPlaying.note, currentlyPlaying.strength);

			}

		}

		else {

			// If we are not blowing, we stop playing the note
			if (currentlyPlaying.on){ 
					// If we were playing a note, we stop playing it

					/*modification de currentlyPlaying pour éviter des problèmes :
					on n'est rien en train de jouer, donc on indique avec on=0 et buttons=-1*/
					currentlyPlaying.on = 0;
					currentlyPlaying.buttons = -1;

					sendNote(0, currentlyPlaying.note, currentlyPlaying.strength);
				}
		}
	}
}
```
