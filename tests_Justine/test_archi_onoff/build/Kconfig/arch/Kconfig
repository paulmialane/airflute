## tests_Justine/test_archi_onoff/build/Kconfig/arch/Kconfig
```kconfig
# Load arch Kconfig descriptions.
osource "C:/Users/justi/zephyr/zephyr/arch/x86/Kconfig"
osource "C:/Users/justi/zephyr/zephyr/arch/xtensa/Kconfig"
osource "C:/Users/justi/zephyr/zephyr/arch/sparc/Kconfig"
osource "C:/Users/justi/zephyr/zephyr/arch/riscv/Kconfig"
osource "C:/Users/justi/zephyr/zephyr/arch/posix/Kconfig"
osource "C:/Users/justi/zephyr/zephyr/arch/nios2/Kconfig"
osource "C:/Users/justi/zephyr/zephyr/arch/mips/Kconfig"
osource "C:/Users/justi/zephyr/zephyr/arch/arm64/Kconfig"
osource "C:/Users/justi/zephyr/zephyr/arch/arm/Kconfig"
osource "C:/Users/justi/zephyr/zephyr/arch/arc/Kconfig"
```

## tests_Justine/test_archi_onoff/build/Kconfig/soc/Kconfig
```kconfig
# Load Zephyr SoC Kconfig descriptions.
osource "C:/Users/justi/zephyr/zephyr/soc/xlnx/zynqmp/Kconfig"
osource "C:/Users/justi/zephyr/zephyr/soc/xlnx/zynq7000/Kconfig"
osource "C:/Users/justi/zephyr/zephyr/soc/xen/Kconfig"
osource "C:/Users/justi/zephyr/zephyr/soc/ti/simplelink/Kconfig"
osource "C:/Users/justi/zephyr/zephyr/soc/ti/lm3s6965/Kconfig"
osource "C:/Users/justi/zephyr/zephyr/soc/ti/k3/Kconfig"
osource "C:/Users/justi/zephyr/zephyr/soc/telink/tlsr/Kconfig"
osource "C:/Users/justi/zephyr/zephyr/soc/synopsys/qemu_arc/Kconfig"
osource "C:/Users/justi/zephyr/zephyr/soc/synopsys/nsim/Kconfig"
osource "C:/Users/justi/zephyr/zephyr/soc/synopsys/hsdk4xd/Kconfig"
osource "C:/Users/justi/zephyr/zephyr/soc/synopsys/hsdk/Kconfig"
osource "C:/Users/justi/zephyr/zephyr/soc/synopsys/emsk/Kconfig"
osource "C:/Users/justi/zephyr/zephyr/soc/synopsys/emsdp/Kconfig"
osource "C:/Users/justi/zephyr/zephyr/soc/synopsys/arc_iot/Kconfig"
osource "C:/Users/justi/zephyr/zephyr/soc/starfive/jh71xx/Kconfig"
osource "C:/Users/justi/zephyr/zephyr/soc/st/stm32/Kconfig"
osource "C:/Users/justi/zephyr/zephyr/soc/silabs/Kconfig"
osource "C:/Users/justi/zephyr/zephyr/soc/sifive/sifive_freedom/Kconfig"
osource "C:/Users/justi/zephyr/zephyr/soc/rockchip/Kconfig"
osource "C:/Users/justi/zephyr/zephyr/soc/riscv/qemu_virt_riscv/Kconfig"
osource "C:/Users/justi/zephyr/zephyr/soc/renode/riscv_virtual/Kconfig"
osource "C:/Users/justi/zephyr/zephyr/soc/renesas/smartbond/Kconfig"
osource "C:/Users/justi/zephyr/zephyr/soc/renesas/rzt2m/Kconfig"
osource "C:/Users/justi/zephyr/zephyr/soc/renesas/rcar/Kconfig"
osource "C:/Users/justi/zephyr/zephyr/soc/renesas/ra/Kconfig"
osource "C:/Users/justi/zephyr/zephyr/soc/raspberrypi/Kconfig"
osource "C:/Users/justi/zephyr/zephyr/soc/quicklogic/eos_s3/Kconfig"
osource "C:/Users/justi/zephyr/zephyr/soc/qemu_malta/Kconfig"
osource "C:/Users/justi/zephyr/zephyr/soc/openisa/rv32m1/Kconfig"
osource "C:/Users/justi/zephyr/zephyr/soc/nxp/s32/Kconfig"
osource "C:/Users/justi/zephyr/zephyr/soc/nxp/rw/Kconfig"
osource "C:/Users/justi/zephyr/zephyr/soc/nxp/mcx/Kconfig"
osource "C:/Users/justi/zephyr/zephyr/soc/nxp/lpc/Kconfig"
osource "C:/Users/justi/zephyr/zephyr/soc/nxp/layerscape/Kconfig"
osource "C:/Users/justi/zephyr/zephyr/soc/nxp/kinetis/Kconfig"
osource "C:/Users/justi/zephyr/zephyr/soc/nxp/imxrt/Kconfig"
osource "C:/Users/justi/zephyr/zephyr/soc/nxp/imx/Kconfig"
osource "C:/Users/justi/zephyr/zephyr/soc/nuvoton/numicro/Kconfig"
osource "C:/Users/justi/zephyr/zephyr/soc/nuvoton/numaker/Kconfig"
osource "C:/Users/justi/zephyr/zephyr/soc/nuvoton/npcx/Kconfig"
osource "C:/Users/justi/zephyr/zephyr/soc/nordic/Kconfig"
osource "C:/Users/justi/zephyr/zephyr/soc/neorv32/Kconfig"
osource "C:/Users/justi/zephyr/zephyr/soc/native/inf_clock/Kconfig"
osource "C:/Users/justi/zephyr/zephyr/soc/microchip/miv/Kconfig"
osource "C:/Users/justi/zephyr/zephyr/soc/microchip/mec/Kconfig"
osource "C:/Users/justi/zephyr/zephyr/soc/lowrisc/opentitan/Kconfig"
osource "C:/Users/justi/zephyr/zephyr/soc/litex/litex_vexriscv/Kconfig"
osource "C:/Users/justi/zephyr/zephyr/soc/ite/ec/Kconfig"
osource "C:/Users/justi/zephyr/zephyr/soc/intel/raptor_lake/Kconfig"
osource "C:/Users/justi/zephyr/zephyr/soc/intel/lakemont/Kconfig"
osource "C:/Users/justi/zephyr/zephyr/soc/intel/intel_socfpga_std/Kconfig"
osource "C:/Users/justi/zephyr/zephyr/soc/intel/intel_socfpga/Kconfig"
osource "C:/Users/justi/zephyr/zephyr/soc/intel/intel_niosv/Kconfig"
osource "C:/Users/justi/zephyr/zephyr/soc/intel/intel_ish/Kconfig"
osource "C:/Users/justi/zephyr/zephyr/soc/intel/intel_adsp/Kconfig"
osource "C:/Users/justi/zephyr/zephyr/soc/intel/elkhart_lake/Kconfig"
osource "C:/Users/justi/zephyr/zephyr/soc/intel/atom/Kconfig"
osource "C:/Users/justi/zephyr/zephyr/soc/intel/apollo_lake/Kconfig"
osource "C:/Users/justi/zephyr/zephyr/soc/intel/alder_lake/Kconfig"
osource "C:/Users/justi/zephyr/zephyr/soc/infineon/xmc/Kconfig"
osource "C:/Users/justi/zephyr/zephyr/soc/gd/gd32/Kconfig"
osource "C:/Users/justi/zephyr/zephyr/soc/gaisler/leon3/Kconfig"
osource "C:/Users/justi/zephyr/zephyr/soc/gaisler/gr716a/Kconfig"
osource "C:/Users/justi/zephyr/zephyr/soc/espressif/Kconfig"
osource "C:/Users/justi/zephyr/zephyr/soc/ene/kb1200/Kconfig"
osource "C:/Users/justi/zephyr/zephyr/soc/efinix/sapphire/Kconfig"
osource "C:/Users/justi/zephyr/zephyr/soc/cypress/Kconfig"
osource "C:/Users/justi/zephyr/zephyr/soc/cdns/xtensa_sample_controller/Kconfig"
osource "C:/Users/justi/zephyr/zephyr/soc/cdns/dc233c/Kconfig"
osource "C:/Users/justi/zephyr/zephyr/soc/brcm/bcmvk/Kconfig"
osource "C:/Users/justi/zephyr/zephyr/soc/brcm/bcm2711/Kconfig"
osource "C:/Users/justi/zephyr/zephyr/soc/atmel/sam0/Kconfig"
osource "C:/Users/justi/zephyr/zephyr/soc/atmel/sam/Kconfig"
osource "C:/Users/justi/zephyr/zephyr/soc/aspeed/Kconfig"
osource "C:/Users/justi/zephyr/zephyr/soc/arm/Kconfig"
osource "C:/Users/justi/zephyr/zephyr/soc/arm/beetle/Kconfig"
osource "C:/Users/justi/zephyr/zephyr/soc/andestech/Kconfig"
osource "C:/Users/justi/zephyr/zephyr/soc/ambiq/Kconfig"
osource "C:/Users/justi/zephyr/zephyr/soc/altr/zephyr_nios2f/Kconfig"
osource "C:/Users/justi/zephyr/zephyr/soc/altr/qemu_nios2/Kconfig"
```

## tests_Justine/test_archi_onoff/build/Kconfig/soc/Kconfig.defconfig
```kconfig
# Load Zephyr SoC Kconfig defconfig.
osource "C:/Users/justi/zephyr/zephyr/soc/xlnx/zynqmp/Kconfig.defconfig"
osource "C:/Users/justi/zephyr/zephyr/soc/xlnx/zynq7000/Kconfig.defconfig"
osource "C:/Users/justi/zephyr/zephyr/soc/xen/Kconfig.defconfig"
osource "C:/Users/justi/zephyr/zephyr/soc/ti/simplelink/Kconfig.defconfig"
osource "C:/Users/justi/zephyr/zephyr/soc/ti/lm3s6965/Kconfig.defconfig"
osource "C:/Users/justi/zephyr/zephyr/soc/ti/k3/Kconfig.defconfig"
osource "C:/Users/justi/zephyr/zephyr/soc/telink/tlsr/Kconfig.defconfig"
osource "C:/Users/justi/zephyr/zephyr/soc/synopsys/qemu_arc/Kconfig.defconfig"
osource "C:/Users/justi/zephyr/zephyr/soc/synopsys/nsim/Kconfig.defconfig"
osource "C:/Users/justi/zephyr/zephyr/soc/synopsys/hsdk4xd/Kconfig.defconfig"
osource "C:/Users/justi/zephyr/zephyr/soc/synopsys/hsdk/Kconfig.defconfig"
osource "C:/Users/justi/zephyr/zephyr/soc/synopsys/emsk/Kconfig.defconfig"
osource "C:/Users/justi/zephyr/zephyr/soc/synopsys/emsdp/Kconfig.defconfig"
osource "C:/Users/justi/zephyr/zephyr/soc/synopsys/arc_iot/Kconfig.defconfig"
osource "C:/Users/justi/zephyr/zephyr/soc/starfive/jh71xx/Kconfig.defconfig"
osource "C:/Users/justi/zephyr/zephyr/soc/st/stm32/Kconfig.defconfig"
osource "C:/Users/justi/zephyr/zephyr/soc/silabs/Kconfig.defconfig"
osource "C:/Users/justi/zephyr/zephyr/soc/sifive/sifive_freedom/Kconfig.defconfig"
osource "C:/Users/justi/zephyr/zephyr/soc/rockchip/Kconfig.defconfig"
osource "C:/Users/justi/zephyr/zephyr/soc/riscv/qemu_virt_riscv/Kconfig.defconfig"
osource "C:/Users/justi/zephyr/zephyr/soc/renode/riscv_virtual/Kconfig.defconfig"
osource "C:/Users/justi/zephyr/zephyr/soc/renesas/smartbond/Kconfig.defconfig"
osource "C:/Users/justi/zephyr/zephyr/soc/renesas/rzt2m/Kconfig.defconfig"
osource "C:/Users/justi/zephyr/zephyr/soc/renesas/rcar/Kconfig.defconfig"
osource "C:/Users/justi/zephyr/zephyr/soc/renesas/ra/Kconfig.defconfig"
osource "C:/Users/justi/zephyr/zephyr/soc/raspberrypi/Kconfig.defconfig"
osource "C:/Users/justi/zephyr/zephyr/soc/quicklogic/eos_s3/Kconfig.defconfig"
osource "C:/Users/justi/zephyr/zephyr/soc/qemu_malta/Kconfig.defconfig"
osource "C:/Users/justi/zephyr/zephyr/soc/openisa/rv32m1/Kconfig.defconfig"
osource "C:/Users/justi/zephyr/zephyr/soc/nxp/s32/Kconfig.defconfig"
osource "C:/Users/justi/zephyr/zephyr/soc/nxp/rw/Kconfig.defconfig"
osource "C:/Users/justi/zephyr/zephyr/soc/nxp/mcx/Kconfig.defconfig"
osource "C:/Users/justi/zephyr/zephyr/soc/nxp/lpc/Kconfig.defconfig"
osource "C:/Users/justi/zephyr/zephyr/soc/nxp/layerscape/Kconfig.defconfig"
osource "C:/Users/justi/zephyr/zephyr/soc/nxp/kinetis/Kconfig.defconfig"
osource "C:/Users/justi/zephyr/zephyr/soc/nxp/imxrt/Kconfig.defconfig"
osource "C:/Users/justi/zephyr/zephyr/soc/nxp/imx/Kconfig.defconfig"
osource "C:/Users/justi/zephyr/zephyr/soc/nuvoton/numicro/Kconfig.defconfig"
osource "C:/Users/justi/zephyr/zephyr/soc/nuvoton/numaker/Kconfig.defconfig"
osource "C:/Users/justi/zephyr/zephyr/soc/nuvoton/npcx/Kconfig.defconfig"
osource "C:/Users/justi/zephyr/zephyr/soc/nordic/Kconfig.defconfig"
osource "C:/Users/justi/zephyr/zephyr/soc/neorv32/Kconfig.defconfig"
osource "C:/Users/justi/zephyr/zephyr/soc/native/inf_clock/Kconfig.defconfig"
osource "C:/Users/justi/zephyr/zephyr/soc/microchip/miv/Kconfig.defconfig"
osource "C:/Users/justi/zephyr/zephyr/soc/microchip/mec/Kconfig.defconfig"
osource "C:/Users/justi/zephyr/zephyr/soc/lowrisc/opentitan/Kconfig.defconfig"
osource "C:/Users/justi/zephyr/zephyr/soc/litex/litex_vexriscv/Kconfig.defconfig"
osource "C:/Users/justi/zephyr/zephyr/soc/ite/ec/Kconfig.defconfig"
osource "C:/Users/justi/zephyr/zephyr/soc/intel/raptor_lake/Kconfig.defconfig"
osource "C:/Users/justi/zephyr/zephyr/soc/intel/lakemont/Kconfig.defconfig"
osource "C:/Users/justi/zephyr/zephyr/soc/intel/intel_socfpga_std/Kconfig.defconfig"
osource "C:/Users/justi/zephyr/zephyr/soc/intel/intel_socfpga/Kconfig.defconfig"
osource "C:/Users/justi/zephyr/zephyr/soc/intel/intel_niosv/Kconfig.defconfig"
osource "C:/Users/justi/zephyr/zephyr/soc/intel/intel_ish/Kconfig.defconfig"
osource "C:/Users/justi/zephyr/zephyr/soc/intel/intel_adsp/Kconfig.defconfig"
osource "C:/Users/justi/zephyr/zephyr/soc/intel/elkhart_lake/Kconfig.defconfig"
osource "C:/Users/justi/zephyr/zephyr/soc/intel/atom/Kconfig.defconfig"
osource "C:/Users/justi/zephyr/zephyr/soc/intel/apollo_lake/Kconfig.defconfig"
osource "C:/Users/justi/zephyr/zephyr/soc/intel/alder_lake/Kconfig.defconfig"
osource "C:/Users/justi/zephyr/zephyr/soc/infineon/xmc/Kconfig.defconfig"
osource "C:/Users/justi/zephyr/zephyr/soc/gd/gd32/Kconfig.defconfig"
osource "C:/Users/justi/zephyr/zephyr/soc/gaisler/leon3/Kconfig.defconfig"
osource "C:/Users/justi/zephyr/zephyr/soc/gaisler/gr716a/Kconfig.defconfig"
osource "C:/Users/justi/zephyr/zephyr/soc/espressif/Kconfig.defconfig"
osource "C:/Users/justi/zephyr/zephyr/soc/ene/kb1200/Kconfig.defconfig"
osource "C:/Users/justi/zephyr/zephyr/soc/efinix/sapphire/Kconfig.defconfig"
osource "C:/Users/justi/zephyr/zephyr/soc/cypress/Kconfig.defconfig"
osource "C:/Users/justi/zephyr/zephyr/soc/cdns/xtensa_sample_controller/Kconfig.defconfig"
osource "C:/Users/justi/zephyr/zephyr/soc/cdns/dc233c/Kconfig.defconfig"
osource "C:/Users/justi/zephyr/zephyr/soc/brcm/bcmvk/Kconfig.defconfig"
osource "C:/Users/justi/zephyr/zephyr/soc/brcm/bcm2711/Kconfig.defconfig"
osource "C:/Users/justi/zephyr/zephyr/soc/atmel/sam0/Kconfig.defconfig"
osource "C:/Users/justi/zephyr/zephyr/soc/atmel/sam/Kconfig.defconfig"
osource "C:/Users/justi/zephyr/zephyr/soc/aspeed/Kconfig.defconfig"
osource "C:/Users/justi/zephyr/zephyr/soc/arm/Kconfig.defconfig"
osource "C:/Users/justi/zephyr/zephyr/soc/arm/beetle/Kconfig.defconfig"
osource "C:/Users/justi/zephyr/zephyr/soc/andestech/Kconfig.defconfig"
osource "C:/Users/justi/zephyr/zephyr/soc/ambiq/Kconfig.defconfig"
osource "C:/Users/justi/zephyr/zephyr/soc/altr/zephyr_nios2f/Kconfig.defconfig"
osource "C:/Users/justi/zephyr/zephyr/soc/altr/qemu_nios2/Kconfig.defconfig"
```
