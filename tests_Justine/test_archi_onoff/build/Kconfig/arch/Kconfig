## tests_Justine/test_archi_onoff/build/Kconfig/soc/Kconfig.soc
```kconfig
# Load SoC Kconfig descriptions.
osource "C:/Users/justi/zephyr/zephyr/soc/xlnx/zynqmp/Kconfig.soc"
osource "C:/Users/justi/zephyr/zephyr/soc/xlnx/zynq7000/Kconfig.soc"
osource "C:/Users/justi/zephyr/zephyr/soc/xen/Kconfig.soc"
osource "C:/Users/justi/zephyr/zephyr/soc/ti/simplelink/Kconfig.soc"
osource "C:/Users/justi/zephyr/zephyr/soc/ti/lm3s6965/Kconfig.soc"
osource "C:/Users/justi/zephyr/zephyr/soc/ti/k3/Kconfig.soc"
osource "C:/Users/justi/zephyr/zephyr/soc/telink/tlsr/Kconfig.soc"
osource "C:/Users/justi/zephyr/zephyr/soc/synopsys/qemu_arc/Kconfig.soc"
osource "C:/Users/justi/zephyr/zephyr/soc/synopsys/nsim/Kconfig.soc"
osource "C:/Users/justi/zephyr/zephyr/soc/synopsys/hsdk4xd/Kconfig.soc"
osource "C:/Users/justi/zephyr/zephyr/soc/synopsys/hsdk/Kconfig.soc"
osource "C:/Users/justi/zephyr/zephyr/soc/synopsys/emsk/Kconfig.soc"
osource "C:/Users/justi/zephyr/zephyr/soc/synopsys/emsdp/Kconfig.soc"
osource "C:/Users/justi/zephyr/zephyr/soc/synopsys/arc_iot/Kconfig.soc"
osource "C:/Users/justi/zephyr/zephyr/soc/starfive/jh71xx/Kconfig.soc"
osource "C:/Users/justi/zephyr/zephyr/soc/st/stm32/Kconfig.soc"
osource "C:/Users/justi/zephyr/zephyr/soc/silabs/Kconfig.soc"
osource "C:/Users/justi/zephyr/zephyr/soc/sifive/sifive_freedom/Kconfig.soc"
osource "C:/Users/justi/zephyr/zephyr/soc/rockchip/Kconfig.soc"
osource "C:/Users/justi/zephyr/zephyr/soc/riscv/qemu_virt_riscv/Kconfig.soc"
osource "C:/Users/justi/zephyr/zephyr/soc/renode/riscv_virtual/Kconfig.soc"
osource "C:/Users/justi/zephyr/zephyr/soc/renesas/smartbond/Kconfig.soc"
osource "C:/Users/justi/zephyr/zephyr/soc/renesas/rzt2m/Kconfig.soc"
osource "C:/Users/justi/zephyr/zephyr/soc/renesas/rcar/Kconfig.soc"
osource "C:/Users/justi/zephyr/zephyr/soc/renesas/ra/Kconfig.soc"
osource "C:/Users/justi/zephyr/zephyr/soc/raspberrypi/Kconfig.soc"
osource "C:/Users/justi/zephyr/zephyr/soc/quicklogic/eos_s3/Kconfig.soc"
osource "C:/Users/justi/zephyr/zephyr/soc/qemu_malta/Kconfig.soc"
osource "C:/Users/justi/zephyr/zephyr/soc/openisa/rv32m1/Kconfig.soc"
osource "C:/Users/justi/zephyr/zephyr/soc/nxp/s32/Kconfig.soc"
osource "C:/Users/justi/zephyr/zephyr/soc/nxp/rw/Kconfig.soc"
osource "C:/Users/justi/zephyr/zephyr/soc/nxp/mcx/Kconfig.soc"
osource "C:/Users/justi/zephyr/zephyr/soc/nxp/lpc/Kconfig.soc"
osource "C:/Users/justi/zephyr/zephyr/soc/nxp/layerscape/Kconfig.soc"
osource "C:/Users/justi/zephyr/zephyr/soc/nxp/kinetis/Kconfig.soc"
osource "C:/Users/justi/zephyr/zephyr/soc/nxp/imxrt/Kconfig.soc"
osource "C:/Users/justi/zephyr/zephyr/soc/nxp/imx/Kconfig.soc"
osource "C:/Users/justi/zephyr/zephyr/soc/nuvoton/numicro/Kconfig.soc"
osource "C:/Users/justi/zephyr/zephyr/soc/nuvoton/numaker/Kconfig.soc"
osource "C:/Users/justi/zephyr/zephyr/soc/nuvoton/npcx/Kconfig.soc"
osource "C:/Users/justi/zephyr/zephyr/soc/nordic/Kconfig.soc"
osource "C:/Users/justi/zephyr/zephyr/soc/neorv32/Kconfig.soc"
osource "C:/Users/justi/zephyr/zephyr/soc/native/inf_clock/Kconfig.soc"
osource "C:/Users/justi/zephyr/zephyr/soc/microchip/miv/Kconfig.soc"
osource "C:/Users/justi/zephyr/zephyr/soc/microchip/mec/Kconfig.soc"
osource "C:/Users/justi/zephyr/zephyr/soc/lowrisc/opentitan/Kconfig.soc"
osource "C:/Users/justi/zephyr/zephyr/soc/litex/litex_vexriscv/Kconfig.soc"
osource "C:/Users/justi/zephyr/zephyr/soc/ite/ec/Kconfig.soc"
osource "C:/Users/justi/zephyr/zephyr/soc/intel/raptor_lake/Kconfig.soc"
osource "C:/Users/justi/zephyr/zephyr/soc/intel/lakemont/Kconfig.soc"
osource "C:/Users/justi/zephyr/zephyr/soc/intel/intel_socfpga_std/Kconfig.soc"
osource "C:/Users/justi/zephyr/zephyr/soc/intel/intel_socfpga/Kconfig.soc"
osource "C:/Users/justi/zephyr/zephyr/soc/intel/intel_niosv/Kconfig.soc"
osource "C:/Users/justi/zephyr/zephyr/soc/intel/intel_ish/Kconfig.soc"
osource "C:/Users/justi/zephyr/zephyr/soc/intel/intel_adsp/Kconfig.soc"
osource "C:/Users/justi/zephyr/zephyr/soc/intel/elkhart_lake/Kconfig.soc"
osource "C:/Users/justi/zephyr/zephyr/soc/intel/atom/Kconfig.soc"
osource "C:/Users/justi/zephyr/zephyr/soc/intel/apollo_lake/Kconfig.soc"
osource "C:/Users/justi/zephyr/zephyr/soc/intel/alder_lake/Kconfig.soc"
osource "C:/Users/justi/zephyr/zephyr/soc/infineon/xmc/Kconfig.soc"
osource "C:/Users/justi/zephyr/zephyr/soc/gd/gd32/Kconfig.soc"
osource "C:/Users/justi/zephyr/zephyr/soc/gaisler/leon3/Kconfig.soc"
osource "C:/Users/justi/zephyr/zephyr/soc/gaisler/gr716a/Kconfig.soc"
osource "C:/Users/justi/zephyr/zephyr/soc/espressif/Kconfig.soc"
osource "C:/Users/justi/zephyr/zephyr/soc/ene/kb1200/Kconfig.soc"
osource "C:/Users/justi/zephyr/zephyr/soc/efinix/sapphire/Kconfig.soc"
osource "C:/Users/justi/zephyr/zephyr/soc/cypress/Kconfig.soc"
osource "C:/Users/justi/zephyr/zephyr/soc/cdns/xtensa_sample_controller/Kconfig.soc"
osource "C:/Users/justi/zephyr/zephyr/soc/cdns/dc233c/Kconfig.soc"
osource "C:/Users/justi/zephyr/zephyr/soc/brcm/bcmvk/Kconfig.soc"
osource "C:/Users/justi/zephyr/zephyr/soc/brcm/bcm2711/Kconfig.soc"
osource "C:/Users/justi/zephyr/zephyr/soc/atmel/sam0/Kconfig.soc"
osource "C:/Users/justi/zephyr/zephyr/soc/atmel/sam/Kconfig.soc"
osource "C:/Users/justi/zephyr/zephyr/soc/aspeed/Kconfig.soc"
osource "C:/Users/justi/zephyr/zephyr/soc/arm/Kconfig.soc"
osource "C:/Users/justi/zephyr/zephyr/soc/arm/beetle/Kconfig.soc"
osource "C:/Users/justi/zephyr/zephyr/soc/andestech/Kconfig.soc"
osource "C:/Users/justi/zephyr/zephyr/soc/ambiq/Kconfig.soc"
osource "C:/Users/justi/zephyr/zephyr/soc/altr/zephyr_nios2f/Kconfig.soc"
osource "C:/Users/justi/zephyr/zephyr/soc/altr/qemu_nios2/Kconfig.soc"
```
