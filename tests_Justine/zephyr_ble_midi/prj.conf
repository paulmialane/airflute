## prj.conf
```kconfig
CONFIG_BOOT_DELAY=5000

CONFIG_BT=y
CONFIG_BT_PERIPHERAL=y
CONFIG_BT_DEVICE_NAME="zephyr-ble-midi"
# CONFIG_BT_DEBUG_LOG=y

CONFIG_BLE_MIDI=y

CONFIG_LOG=y
CONFIG_BLE_MIDI_LOG_LEVEL_INF=y

# Request a large MTU to reduce the risk of
# dropped data when sending lots of MIDI messages at once.
# Also increases streaming sysex throughput.
# https://docs.zephyrproject.org/latest/samples/bluetooth/mtu_update/README.html
CONFIG_BT_L2CAP_TX_MTU=247
CONFIG_BT_BUF_ACL_TX_SIZE=251
CONFIG_BT_BUF_ACL_RX_SIZE=251
CONFIG_BLE_MIDI_TX_PACKET_MAX_SIZE=244

CONFIG_RING_BUFFER=y

# CONFIG_BLE_MIDI_TX_MODE_SINGLE_MSG=y
# CONFIG_BLE_MIDI_TX_MODE_MANUAL=y
# CONFIG_BLE_MIDI_TX_MODE_NRF_RADIO_NOTIF=y

# CONFIG_ASSERT=y
# CONFIG_DEBUG_OPTIMIZATIONS=y
# CONFIG_DEBUG_THREAD_INFO=y
```

## src/main.c
```c
#include <zephyr/kernel.h>
#include <zephyr/drivers/gpio.h>
#include <zephyr/bluetooth/uuid.h>
#include <zephyr/bluetooth/gatt.h>
#include <zephyr/bluetooth/bluetooth.h>
#include <zephyr/sys/ring_buffer.h>
#include <ble_midi/ble_midi.h>

/************************ App state ************************/
K_MSGQ_DEFINE(button_event_q, sizeof(uint8_t), 128, 4);

#define SYSEX_TX_MESSAGE_SIZE 2000
#define SYSEX_TX_MAX_CHUNK_SIZE 240

struct sample_app_state_t
{
        int ble_midi_is_available;
        int sysex_rx_data_byte_count;
        int sysex_tx_data_byte_count;
        int sysex_tx_in_progress;
        int button_states[4];
};

static struct sample_app_state_t sample_app_state = {.ble_midi_is_available = 0,
                                                     .sysex_tx_data_byte_count = 0,
                                                     .sysex_tx_in_progress = 0,
                                                     .sysex_rx_data_byte_count = 0,
                                                     .button_states = {0, 0, 0, 0}};

/* Ringbuf/work queue */
RING_BUF_DECLARE(midi_msg_ringbuf, 128);
static void midi_msg_work_cb(struct k_work *w)
{
        uint8_t data[4] = {0, 0, 0, 0};
        while (ring_buf_get(&midi_msg_ringbuf, &data, 4) == 4)
        {
                uint8_t msg_byte_count = data[0];
                uint8_t *msg_bytes = &data[1];
                printk("incoming MIDI message ");
                for (int i = 0; i < msg_byte_count; i++)
                {
                        printk("%02x ", msg_bytes[i]);
                }
                printk("\n");
        };
}
static K_WORK_DEFINE(midi_msg_work, midi_msg_work_cb);

/****************** BLE MIDI callbacks ******************/
static void ble_midi_available_cb(int is_available)
{
        printk("ble_midi_is_available : %d", is_available);
        sample_app_state.ble_midi_is_available = is_available;
}

static void tx_done_cb()
{
        if (sample_app_state.sysex_tx_in_progress)
        {
                if (sample_app_state.sysex_tx_data_byte_count == SYSEX_TX_MESSAGE_SIZE)
                {
                        ble_midi_tx_sysex_end();
                        sample_app_state.sysex_tx_in_progress = 0;
                }
                else
                {
                        uint8_t chunk[SYSEX_TX_MAX_CHUNK_SIZE];
                        for (int i = 0; i < SYSEX_TX_MAX_CHUNK_SIZE; i++)
                        {
                                chunk[i] = (sample_app_state.sysex_tx_data_byte_count + i) % 128;
                        }
                        int num_bytes_left =
                            SYSEX_TX_MESSAGE_SIZE - sample_app_state.sysex_tx_data_byte_count;
                        int num_bytes_to_send = num_bytes_left < SYSEX_TX_MAX_CHUNK_SIZE
                                                    ? num_bytes_left
                                                    : SYSEX_TX_MAX_CHUNK_SIZE;
                        int num_bytes_sent = ble_midi_tx_sysex_data(chunk, num_bytes_to_send);
                        sample_app_state.sysex_tx_data_byte_count += num_bytes_sent;
                }
        }
}

/** Called when a non-sysex message has been parsed */
static void ble_midi_message_cb(uint8_t *bytes, uint8_t num_bytes, uint16_t timestamp)
{
        uint8_t data[4] = {num_bytes, 0, 0, 0};
        for (int i = 0; i < num_bytes; i++)
        {
                data[i + 1] = bytes[i];
        }
        uint32_t num_bytes_written = ring_buf_put(&midi_msg_ringbuf, &data, 4);
        __ASSERT(num_bytes_written == 4, "Failed to write to MIDI msg ringbuf");
        int submit_rc = k_work_submit(&midi_msg_work);
}

/** Called when a sysex message starts */
static void ble_midi_sysex_start_cb(uint16_t timestamp)
{
        printk("rx sysex start, t %d\n", timestamp);
}
/** Called when a sysex data byte has been received */
static void ble_midi_sysex_data_cb(uint8_t data_byte)
{
        printk("rx sysex byte %02x\n", data_byte);
}
/** Called when a sysex message ends */
static void ble_midi_sysex_end_cb(uint16_t timestamp)
{
        printk("rx sysex end, t %d\n", timestamp);
}

#define DEVICE_NAME CONFIG_BT_DEVICE_NAME
#define DEVICE_NAME_LEN (sizeof(DEVICE_NAME) - 1)

static const struct bt_data ad[] = {
    BT_DATA_BYTES(BT_DATA_FLAGS, (BT_LE_AD_GENERAL | BT_LE_AD_NO_BREDR)),
    BT_DATA(BT_DATA_NAME_COMPLETE, DEVICE_NAME, DEVICE_NAME_LEN)};

static const struct bt_data sd[] = {
    BT_DATA_BYTES(BT_DATA_UUID128_ALL, BLE_MIDI_SERVICE_UUID),
};

int main(void)
{
        uint32_t err = bt_enable(NULL);
        __ASSERT(err == 0, "bt_enable failed");

        /* Must be called after bt_enable */
        struct ble_midi_callbacks midi_callbacks = {.available_cb = ble_midi_available_cb,
                                                    .tx_done_cb = tx_done_cb,
                                                    .midi_message_cb = ble_midi_message_cb,
                                                    .sysex_start_cb = ble_midi_sysex_start_cb,
                                                    .sysex_data_cb = ble_midi_sysex_data_cb,
                                                    .sysex_end_cb = ble_midi_sysex_end_cb};
        ble_midi_init(&midi_callbacks);

        int ad_err = bt_le_adv_start(BT_LE_ADV_CONN, ad, ARRAY_SIZE(ad), sd, ARRAY_SIZE(sd));
        printk("bt_le_adv_start %d\n", ad_err);

        while (1)
        {
                if (!sample_app_state.sysex_tx_in_progress)
                {
                        uint8_t chord_msgs_1[][3] = {
                            // Note on + pitch + velocity
                            {0x90, 42, 0x7f},
                            {0x90, 36, 0x7f},
                        };
                        ble_midi_tx_msg(&(chord_msgs_1[0][0]));
                        ble_midi_tx_msg(&(chord_msgs_1[1][0]));
                        k_sleep(K_MSEC(500));
                        uint8_t chord_msgs_2_4[][3] = {
                            // Note on + pitch + velocity
                            {0x90, 42, 0x7f},
                        };
                        ble_midi_tx_msg(&(chord_msgs_2_4[0][0]));
                        k_sleep(K_MSEC(500));
                        uint8_t chord_msgs_3[][3] = {
                            // Note on + pitch + velocity
                            {0x90, 42, 0x7f},
                            {0x90, 38, 0x7f},
                        };
                        ble_midi_tx_msg(&(chord_msgs_3[0][0]));
                        ble_midi_tx_msg(&(chord_msgs_3[1][0]));
                        k_sleep(K_MSEC(500));
                        ble_midi_tx_msg(&(chord_msgs_2_4[0][0]));
                        k_sleep(K_MSEC(500));
                }
        }
}
```
